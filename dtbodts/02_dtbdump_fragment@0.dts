/dts-v1/;

/ {

	__fixups__ {
		accdet = "/fragment@31:target:0";
		auxadc = "/fragment@8/__overlay__:io-channels:40", "/fragment@10/__overlay__:io-channels:0", "/fragment@10/__overlay__:io-channels:8", "/fragment@10/__overlay__:io-channels:16";
		camera_af_hw_node = "/fragment@56:target:0";
		charger = "/fragment@10:target:0", "/fragment@19:target:0";
		chosen = "/fragment@29:target:0";
		clock_buffer_ctrl = "/fragment@26:target:0";
		dispsys_config = "/fragment@40:target:0";
		dsi0 = "/fragment@41:target:0";
		dsi_te = "/fragment@88:target:0";
		extcon_usb = "/fragment@18:target:0";
		goodix_fp = "/fragment@45:target:0", "/fragment@86:target:0";
		gpio = "/fragment@81:target:0";
		gpio_usage_mapping = "/fragment@80:target:0";
		gps = "/fragment@48:target:0";
		i2c0 = "/fragment@30:target:0", "/fragment@49:target:0", "/fragment@70:target:0";
		i2c1 = "/fragment@71:target:0";
		i2c2 = "/fragment@2:target:0", "/fragment@55:target:0", "/fragment@72:target:0";
		i2c3 = "/fragment@28:target:0", "/fragment@73:target:0";
		i2c4 = "/fragment@3:target:0", "/fragment@74:target:0";
		i2c5 = "/fragment@52:target:0", "/fragment@57:target:0", "/fragment@75:target:0";
		i2c6 = "/fragment@58:target:0", "/fragment@76:target:0";
		i2c7 = "/fragment@12:target:0", "/fragment@77:target:0";
		i2c8 = "/fragment@13:target:0", "/fragment@78:target:0";
		i2c9 = "/fragment@79:target:0";
		kd_camera_hw1 = "/fragment@1:target:0";
		keypad = "/fragment@63:target:0", "/fragment@91:target:0";
		lk_charger = "/fragment@11:target:0";
		md1_sim1_hot_plug_eint = "/fragment@89:target:0";
		md1_sim2_hot_plug_eint = "/fragment@90:target:0";
		mobicore = "/fragment@35:target:0";
		mrdump_ext_rst = "/fragment@82:target:0";
		mt6358_vio28_reg = "/fragment@49/__overlay__/gt9886@5d:vtouch-supply:0", "/fragment@50/__overlay__/gt9896s@0:vtouch-supply:0";
		mtee_svp = "/fragment@65:target:0";
		mtk_composite_v4l2_1 = "/fragment@54:target:0";
		mtk_gauge = "/fragment@8:target:0", "/fragment@10/__overlay__:gauge:0";
		mtk_leds = "/fragment@37:target:0";
		mtkfb = "/fragment@39:target:0";
		odm = "/fragment@6:target:0", "/fragment@22:target:0", "/fragment@24:target:0", "/fragment@25:target:0", "/fragment@36:target:0", "/fragment@61:target:0", "/fragment@62:target:0";
		oplus_fp_common = "/fragment@42:target:0";
		pio = "/fragment@0:target:0", "/fragment@5:target:0", "/fragment@6/__overlay__/sia81xx@L:si,sia81xx_reset:0", "/fragment@6/__overlay__/sia81xx@L:si,sia81xx_owi:0", "/fragment@6/__overlay__/sia81xx@L:si,sia81xx_id:0", "/fragment@8/__overlay__:ntc_switch_gpio:0", "/fragment@10/__overlay__:qcom,chargerid_switch-gpio:0", "/fragment@10/__overlay__:qcom,dischg-gpio:0", "/fragment@12/__overlay__/sc8547-charger@6F:qcom,irq_gpio:0", "/fragment@12/__overlay__/sc8547-charger@6F:interrupt-parent:0", "/fragment@12/__overlay__/sc8547-charger@6F:qcom,charging_switch1-gpio:0", "/fragment@15:target:0", "/fragment@22/__overlay__/optiga:data-gpio:0", "/fragment@23:target:0", "/fragment@27:target:0", "/fragment@28/__overlay__/nfc_nxp@28:nxp,pn544-irq:0", "/fragment@28/__overlay__/nfc_nxp@28:nxp,pn544-ven:0", "/fragment@28/__overlay__/nfc_nxp@28:nxp,pn544-fw-dwnld:0", "/fragment@28/__overlay__/nfc_nxp@28:nxp,pn544-clkreq:0", "/fragment@28/__overlay__/nfc_nxp@28:interrupt-parent:0", "/fragment@30/__overlay__/Focaltech22681@38:interrupt-parent:0", "/fragment@30/__overlay__/Focaltech22681@38:enable2v8_gpio:0", "/fragment@30/__overlay__/Focaltech22681@38:irq-gpio:0", "/fragment@30/__overlay__/Focaltech22681@38:reset-gpio:0", "/fragment@33:target:0", "/fragment@34:target:0", "/fragment@38:target:0", "/fragment@41/__overlay__/panel1@0:reset-gpios:0", "/fragment@41/__overlay__/panel1@0:bias-gpios:0", "/fragment@42/__overlay__:oplus,fp_gpio_0:0", "/fragment@43:target:0", "/fragment@45/__overlay__:goodix,gpio_irq:0", "/fragment@45/__overlay__:goodix,gpio_reset:0", "/fragment@45/__overlay__:goodix,gpio_cs:0", "/fragment@45/__overlay__:interrupt-parent:0", "/fragment@46:target:0", "/fragment@47:target:0", "/fragment@49/__overlay__/gt9886@5d:interrupt-parent:0", "/fragment@49/__overlay__/gt9886@5d:goodix,reset-gpio:0", "/fragment@49/__overlay__/gt9886@5d:goodix,irq-gpio:0", "/fragment@50/__overlay__/gt9896s@0:goodix,reset-gpio:0", "/fragment@50/__overlay__/gt9896s@0:goodix,irq-gpio:0", "/fragment@51:target:0", "/fragment@53:target:0", "/fragment@57/__overlay__/bq2589x@6a:interrupt-parent:0", "/fragment@60:target:0", "/fragment@61/__overlay__/oplus_devinfo/main-sub:aboard-gpio0:0", "/fragment@61/__overlay__/kpd_volume_down:interrupt-parent:0", "/fragment@62/__overlay__/oplus_sim_detect:Hw,sim_det:0", "/fragment@63/__overlay__:keypad,volume-down:0", "/fragment@64:target:0", "/fragment@80/__overlay__:GPIO_SIM1_HOT_PLUG:0", "/fragment@80/__overlay__:GPIO_SIM1_SCLK:0", "/fragment@80/__overlay__:GPIO_SIM1_SRST:0", "/fragment@80/__overlay__:GPIO_SIM1_SIO:0", "/fragment@80/__overlay__:GPIO_SIM2_SCLK:0", "/fragment@80/__overlay__:GPIO_SIM2_SRST:0", "/fragment@80/__overlay__:GPIO_SIM2_SIO:0", "/fragment@80/__overlay__:GPIO_FDD_BAND_SUPPORT_DETECT_1ST_PIN:0", "/fragment@80/__overlay__:GPIO_FDD_BAND_SUPPORT_DETECT_2ND_PIN:0", "/fragment@80/__overlay__:GPIO_FDD_BAND_SUPPORT_DETECT_3RD_PIN:0", "/fragment@82/__overlay__:interrupt-parent:0", "/fragment@83/__overlay__:interrupt-parent:0", "/fragment@84/__overlay__:interrupt-parent:0", "/fragment@85/__overlay__:interrupt-parent:0", "/fragment@86/__overlay__:interrupt-parent:0", "/fragment@87/__overlay__:interrupt-parent:0", "/fragment@87/__overlay__:deb-gpios:0", "/fragment@88/__overlay__:interrupt-parent:0";
		pmic_auxadc = "/fragment@8/__overlay__:io-channels:0", "/fragment@8/__overlay__:io-channels:8", "/fragment@8/__overlay__:io-channels:16", "/fragment@8/__overlay__:io-channels:24", "/fragment@8/__overlay__:io-channels:32";
		regulator_vibrator = "/fragment@16:target:0";
		rt5133_gpio1 = "/fragment@56/__overlay__:camaf_m3_pmic-supply:0";
		rt5133_ldo3 = "/fragment@56/__overlay__:camaf_m1_pmic-supply:0";
		sgm7220_typec = "/fragment@21:target:0";
		smart_pa = "/fragment@84:target:0";
		soc = "/fragment@67:target:0";
		sound = "/fragment@7:target:0", "/fragment@59:target:0";
		spi0 = "/fragment@50:target:0";
		spi3 = "/fragment@44:target:0";
		subpmic_pmu_eint = "/fragment@83:target:0";
		swtp = "/fragment@68:target:0", "/fragment@87:target:0";
		swtp_1 = "/fragment@69:target:0";
		tboard_thermistor5 = "/fragment@66/__overlay__/charger_ts_ntc:thermal-sensors:0";
		tboard_thermistor6 = "/fragment@66/__overlay__/sub_bat_temp_ntc:thermal-sensors:0";
		tboard_thermistor7 = "/fragment@66/__overlay__/flash_led_ntc:thermal-sensors:0";
		thermal_zones = "/fragment@4:target:0", "/fragment@66:target:0";
		touch = "/fragment@85:target:0";
		u2port0 = "/fragment@9:target:0";
		uart0 = "/fragment@32:target:0";
		uart1 = "/fragment@14:target:0";
		usb = "/fragment@17:target:0";
		wusb3801x_typec = "/fragment@20:target:0";
	};

	__local_fixups__ {

		fragment@1 {

			__overlay__ {
				pinctrl-0 = <0x0>;
				pinctrl-1 = <0x0>;
				pinctrl-10 = <0x0>;
				pinctrl-11 = <0x0>;
				pinctrl-12 = <0x0>;
				pinctrl-13 = <0x0>;
				pinctrl-14 = <0x0>;
				pinctrl-15 = <0x0>;
				pinctrl-16 = <0x0>;
				pinctrl-17 = <0x0>;
				pinctrl-18 = <0x0>;
				pinctrl-19 = <0x0>;
				pinctrl-2 = <0x0>;
				pinctrl-20 = <0x0>;
				pinctrl-21 = <0x0>;
				pinctrl-22 = <0x0>;
				pinctrl-23 = <0x0>;
				pinctrl-24 = <0x0>;
				pinctrl-25 = <0x0>;
				pinctrl-3 = <0x0>;
				pinctrl-4 = <0x0>;
				pinctrl-5 = <0x0>;
				pinctrl-6 = <0x0>;
				pinctrl-7 = <0x0>;
				pinctrl-8 = <0x0>;
				pinctrl-9 = <0x0>;
			};
		};

		fragment@10 {

			__overlay__ {
				charger = <0x0>;
				pinctrl-0 = <0x0>;
				pinctrl-1 = <0x0>;
				pinctrl-2 = <0x0>;
				pinctrl-3 = <0x0>;
				pinctrl-4 = <0x0>;
				pinctrl-5 = <0x0>;
			};
		};

		fragment@12 {

			__overlay__ {

				sc8547-charger@6F {
					pinctrl-0 = <0x0>;
					pinctrl-1 = <0x0>;
					pinctrl-2 = <0x0>;
					pinctrl-3 = <0x0>;
				};
			};
		};

		fragment@17 {

			__overlay__ {
				charger = <0x0>;
			};
		};

		fragment@18 {

			__overlay__ {
				charger = <0x0>;
			};
		};

		fragment@19 {

			__overlay__ {
				charger = <0x0>;
			};
		};

		fragment@20 {

			__overlay__ {
				charger = <0x0>;
			};
		};

		fragment@21 {

			__overlay__ {
				charger = <0x0>;
			};
		};

		fragment@22 {

			__overlay__ {

				optiga {
					pinctrl-0 = <0x0>;
				};
			};
		};

		fragment@28 {

			__overlay__ {
				pinctrl-0 = <0x0>;
			};
		};

		fragment@32 {

			__overlay__ {
				pinctrl-0 = <0x0>;
				pinctrl-1 = <0x0>;
			};
		};

		fragment@39 {

			__overlay__ {
				pinctrl-0 = <0x0>;
				pinctrl-1 = <0x0>;
				pinctrl-2 = <0x0>;
				pinctrl-3 = <0x0>;
				pinctrl-4 = <0x0>;
			};
		};

		fragment@4 {

			__overlay__ {

				camera_main {
					thermal-sensors = <0x0>;
				};

				camera_main_two {
					thermal-sensors = <0x0>;
				};

				camera_sub {
					thermal-sensors = <0x0>;
				};
			};
		};

		fragment@40 {

			__overlay__ {
				pinctrl-0 = <0x0>;
				pinctrl-1 = <0x0>;
				pinctrl-2 = <0x0>;
			};
		};

		fragment@41 {

			__overlay__ {

				panel1@0 {

					port {

						endpoint {
							remote-endpoint = <0x0>;
						};
					};
				};

				ports {

					port {

						endpoint {
							remote-endpoint = <0x0>;
						};
					};
				};
			};
		};

		fragment@42 {

			__overlay__ {
				pinctrl-0 = <0x0>;
				pinctrl-1 = <0x0>;
				pinctrl-2 = <0x0>;
			};
		};

		fragment@45 {

			__overlay__ {
				pinctrl-0 = <0x0 0x4>;
				pinctrl-1 = <0x0>;
			};
		};

		fragment@48 {

			__overlay__ {
				pinctrl-0 = <0x0>;
				pinctrl-1 = <0x0>;
				pinctrl-2 = <0x0>;
				pinctrl-3 = <0x0>;
				pinctrl-4 = <0x0>;
				pinctrl-5 = <0x0>;
				pinctrl-6 = <0x0>;
			};
		};

		fragment@49 {

			__overlay__ {
				pinctrl-0 = <0x0>;
				pinctrl-1 = <0x0>;
				pinctrl-2 = <0x0>;
				pinctrl-3 = <0x0>;
				pinctrl-4 = <0x0>;
				pinctrl-5 = <0x0>;
			};
		};

		fragment@50 {

			__overlay__ {
				pinctrl-0 = <0x0>;
				pinctrl-1 = <0x0>;
				pinctrl-2 = <0x0>;
				pinctrl-3 = <0x0>;
				pinctrl-4 = <0x0>;
				pinctrl-5 = <0x0>;
			};
		};

		fragment@52 {

			__overlay__ {

				aw36518@63 {
					pinctrl-0 = <0x0>;
					pinctrl-1 = <0x0>;
					pinctrl-2 = <0x0>;

					flash@0 {

						port@0 {

							endpoint {
								remote-endpoint = <0x0>;
							};
						};
					};
				};
			};
		};

		fragment@54 {

			__overlay__ {

				port@0 {

					endpoint {
						remote-endpoint = <0x0>;
					};
				};
			};
		};

		fragment@59 {

			__overlay__ {

				mediatek,speaker-codec {
					sound-dai = <0x0>;
				};
			};
		};

		fragment@6 {

			__overlay__ {

				sia81xx@L {
					pinctrl-0 = <0x0>;
					pinctrl-1 = <0x0>;
				};
			};
		};

		fragment@61 {

			__overlay__ {

				oplus_devinfo {
					pinctrl-0 = <0x0>;
					pinctrl-1 = <0x0>;
					pinctrl-2 = <0x0>;
					pinctrl-3 = <0x0>;
				};
			};
		};

		fragment@63 {

			__overlay__ {
				pinctrl-0 = <0x0>;
			};
		};

		fragment@7 {

			__overlay__ {
				si,sia81xx-aux-devs = <0x0>;
			};
		};

		fragment@8 {

			__overlay__ {
				charger = <0x0>;
			};
		};
	};

	__symbols__ {
		aboard_pin_gpio0_active = "/fragment@60/__overlay__/active@id0";
		aboard_pin_gpio0_idle = "/fragment@60/__overlay__/idle@id0";
		aboard_pin_gpio0_sleep = "/fragment@60/__overlay__/sleep@id0";
		alsps_arch = "/fragment@24/__overlay__/oplus_sensor/alsps_arch";
		aw36518 = "/fragment@52/__overlay__/aw36518@63";
		aw36518_pins_default = "/fragment@53/__overlay__/default";
		aw36518_pins_hwen_high = "/fragment@53/__overlay__/hwen_high";
		aw36518_pins_hwen_low = "/fragment@53/__overlay__/hwen_low";
		bq2589x = "/fragment@57/__overlay__/bq2589x@6a";
		cali_arch = "/fragment@24/__overlay__/oplus_sensor/cali_arch";
		camera_main = "/fragment@4/__overlay__/camera_main";
		camera_main_af_mtk = "/fragment@2/__overlay__/camera_main_af@18";
		camera_main_mtk = "/fragment@2/__overlay__/camera_main@5a";
		camera_main_three_af_mtk = "/fragment@55/__overlay__/camera_main_three_af@0c";
		camera_main_two = "/fragment@4/__overlay__/camera_main_two";
		camera_main_two_mtk = "/fragment@3/__overlay__/camera_main_two@78";
		camera_pins_cam0_mclk_2ma = "/fragment@0/__overlay__/camera_pins_cam0_mclk_2ma";
		camera_pins_cam0_mclk_4ma = "/fragment@0/__overlay__/camera_pins_cam0_mclk_4ma";
		camera_pins_cam0_mclk_6ma = "/fragment@0/__overlay__/camera_pins_cam0_mclk_6ma";
		camera_pins_cam0_mclk_8ma = "/fragment@0/__overlay__/camera_pins_cam0_mclk_8ma";
		camera_pins_cam0_mclk_off = "/fragment@0/__overlay__/camera_pins_cam0_mclk_off";
		camera_pins_cam0_rst_0 = "/fragment@0/__overlay__/cam0@0";
		camera_pins_cam0_rst_1 = "/fragment@0/__overlay__/cam0@1";
		camera_pins_cam1_mclk_2ma = "/fragment@0/__overlay__/camera_pins_cam1_mclk_2ma";
		camera_pins_cam1_mclk_4ma = "/fragment@0/__overlay__/camera_pins_cam1_mclk_4ma";
		camera_pins_cam1_mclk_6ma = "/fragment@0/__overlay__/camera_pins_cam1_mclk_6ma";
		camera_pins_cam1_mclk_8ma = "/fragment@0/__overlay__/camera_pins_cam1_mclk_8ma";
		camera_pins_cam1_mclk_off = "/fragment@0/__overlay__/camera_pins_cam1_mclk_off";
		camera_pins_cam1_rst_0 = "/fragment@0/__overlay__/cam1@0";
		camera_pins_cam1_rst_1 = "/fragment@0/__overlay__/cam1@1";
		camera_pins_cam1_vcama1_0 = "/fragment@0/__overlay__/cam1@2";
		camera_pins_cam1_vcama1_1 = "/fragment@0/__overlay__/cam1@3";
		camera_pins_cam2_mclk_2ma = "/fragment@0/__overlay__/camera_pins_cam2_mclk_2ma";
		camera_pins_cam2_mclk_4ma = "/fragment@0/__overlay__/camera_pins_cam2_mclk_4ma";
		camera_pins_cam2_mclk_6ma = "/fragment@0/__overlay__/camera_pins_cam2_mclk_6ma";
		camera_pins_cam2_mclk_8ma = "/fragment@0/__overlay__/camera_pins_cam2_mclk_8ma";
		camera_pins_cam2_mclk_off = "/fragment@0/__overlay__/camera_pins_cam2_mclk_off";
		camera_pins_cam2_rst_0 = "/fragment@0/__overlay__/cam2@0";
		camera_pins_cam2_rst_1 = "/fragment@0/__overlay__/cam2@1";
		camera_pins_cam2_vcama1_0 = "/fragment@0/__overlay__/cam2@2";
		camera_pins_cam2_vcama1_1 = "/fragment@0/__overlay__/cam2@3";
		camera_pins_default = "/fragment@0/__overlay__/camdefault";
		camera_sub = "/fragment@4/__overlay__/camera_sub";
		camera_sub_mtk = "/fragment@3/__overlay__/camera_sub@20";
		ccdetect_active = "/fragment@15/__overlay__/ccdetect_active";
		ccdetect_sleep = "/fragment@15/__overlay__/ccdetect_sleep";
		charger_gpio_as_output_high = "/fragment@15/__overlay__/charger_gpio_as_output_high";
		charger_gpio_as_output_low = "/fragment@15/__overlay__/charger_gpio_as_output_low";
		charger_ts_ntc = "/fragment@66/__overlay__/charger_ts_ntc";
		charging_inter_active = "/fragment@15/__overlay__/charging_inter_active";
		charging_inter_sleep = "/fragment@15/__overlay__/charging_inter_sleep";
		charging_switch1_active = "/fragment@15/__overlay__/charging_switch1_active";
		charging_switch1_sleep = "/fragment@15/__overlay__/charging_switch1_sleep";
		ctp_gt9896s_int_active = "/fragment@51/__overlay__/int1_active";
		ctp_gt9896s_int_suspend = "/fragment@51/__overlay__/int1_suspend";
		ctp_gt9896s_pins_default = "/fragment@51/__overlay__/pins_default";
		ctp_gt9896s_reset_active = "/fragment@51/__overlay__/reset1_active";
		ctp_gt9896s_reset_suspend = "/fragment@51/__overlay__/reset1_suspend";
		ctp_gt9896s_spi_mode = "/fragment@51/__overlay__/spimode_default";
		ctp_pins_default = "/fragment@51/__overlay__/eintdefault";
		ctp_pins_default_t = "/fragment@34/__overlay__/eintdefault";
		ctp_ts_i2c_mode = "/fragment@51/__overlay__/i2cmode_default";
		ctp_ts_int_active = "/fragment@51/__overlay__/int_active";
		ctp_ts_int_active_t = "/fragment@34/__overlay__/int_active";
		ctp_ts_int_suspend = "/fragment@51/__overlay__/int_suspend";
		ctp_ts_int_suspend_t = "/fragment@34/__overlay__/int_suspend";
		ctp_ts_reset_active = "/fragment@51/__overlay__/reset_active";
		ctp_ts_reset_active_t = "/fragment@34/__overlay__/reset_active";
		ctp_ts_reset_suspend = "/fragment@51/__overlay__/reset_suspend";
		ctp_ts_reset_suspend_t = "/fragment@34/__overlay__/reset_suspend";
		dischg_disable = "/fragment@15/__overlay__/dischg_disable";
		dischg_enable = "/fragment@15/__overlay__/dischg_enable";
		dsi_out = "/fragment@41/__overlay__/ports/port/endpoint";
		fl_core_0 = "/fragment@52/__overlay__/aw36518@63/flash@0/port@0/endpoint";
		flash_led_ntc = "/fragment@66/__overlay__/flash_led_ntc";
		flashlight_0 = "/fragment@54/__overlay__/port@0/endpoint";
		gpio_goodix_cs_func = "/fragment@46/__overlay__/gpio_goodix_cs_func";
		gpio_goodix_irq_default = "/fragment@46/__overlay__/gpio_goodix_irq_default";
		gpio_goodix_reset_default = "/fragment@46/__overlay__/gpio_goodix_reset_default";
		gpio_id0_default = "/fragment@43/__overlay__/gpio_id0_default";
		gpio_id0_pull_down = "/fragment@43/__overlay__/gpio_id0_pull_down";
		gpio_id0_pull_up = "/fragment@43/__overlay__/gpio_id0_pull_up";
		gps_l1_lna_pins_dsp_ctrl = "/fragment@47/__overlay__/gps_l1_lna@1";
		gps_l1_lna_pins_oh = "/fragment@47/__overlay__/gps_l1_lna@2";
		gps_l1_lna_pins_ol = "/fragment@47/__overlay__/gps_l1_lna@0";
		gps_l5_lna_pins_dsp_ctrl = "/fragment@47/__overlay__/gps_l5_lna@1";
		gps_l5_lna_pins_oh = "/fragment@47/__overlay__/gps_l5_lna@2";
		gps_l5_lna_pins_ol = "/fragment@47/__overlay__/gps_l5_lna@0";
		gps_pins_default = "/fragment@47/__overlay__/gps_default";
		gsensor_1 = "/fragment@24/__overlay__/oplus_sensor/gsensor_1";
		gsensor_2 = "/fragment@24/__overlay__/oplus_sensor/gsensor_2";
		hw_pins_default = "/fragment@60/__overlay__/default@hw_sub_id";
		i2c3_pin = "/fragment@27/__overlay__/i2c3_pin";
		kpd_volume_down = "/fragment@61/__overlay__/kpd_volume_down";
		led0 = "/fragment@36/__overlay__/led@0";
		led1 = "/fragment@36/__overlay__/led@1";
		led2 = "/fragment@36/__overlay__/led@2";
		led3 = "/fragment@36/__overlay__/led@3";
		led4 = "/fragment@36/__overlay__/led@4";
		led5 = "/fragment@36/__overlay__/led@5";
		led6 = "/fragment@36/__overlay__/led@6";
		light_1 = "/fragment@24/__overlay__/oplus_sensor/light_1";
		lux_aod = "/fragment@24/__overlay__/oplus_sensor/lux_aod";
		msensor_1 = "/fragment@24/__overlay__/oplus_sensor/msensor_1";
		mtee = "/fragment@65/__overlay__/MTEE";
		mtk_camera_eeprom0 = "/fragment@2/__overlay__/camera_eeprom0@11";
		mtk_camera_eeprom1 = "/fragment@3/__overlay__/camera_eeprom1@54";
		mtkfb_pins_lcm_dsi_te = "/fragment@38/__overlay__/lcm_dsi_te";
		mtkfb_pins_lcm_led_en0 = "/fragment@38/__overlay__/lcm_led_en0_gpio";
		mtkfb_pins_lcm_led_en1 = "/fragment@38/__overlay__/lcm_led_en1_gpio";
		mtkfb_pins_lcm_rst_out0_gpio = "/fragment@38/__overlay__/lcm_rst_out0_gpio";
		mtkfb_pins_lcm_rst_out1_gpio = "/fragment@38/__overlay__/lcm_rst_out1_gpio";
		nfc_chipset = "/fragment@25/__overlay__/nfc_chipset";
		oplus_boardid = "/fragment@61/__overlay__/oplus_boardid";
		oplus_devinfo = "/fragment@61/__overlay__/oplus_devinfo";
		oplus_fp = "/fragment@44/__overlay__/fingerprint@0";
		oplus_project = "/fragment@61/__overlay__/oplus_project";
		oplus_sensor = "/fragment@24/__overlay__/oplus_sensor";
		optiga_active = "/fragment@23/__overlay__/optiga_active";
		panel_in1 = "/fragment@41/__overlay__/panel1@0/port/endpoint";
		pick_up = "/fragment@24/__overlay__/oplus_sensor/pick_up";
		proximity_1 = "/fragment@24/__overlay__/oplus_sensor/proximity_1";
		sar_1 = "/fragment@24/__overlay__/oplus_sensor/sar_1";
		sar_2 = "/fragment@24/__overlay__/oplus_sensor/sar_2";
		sensor_fb = "/fragment@24/__overlay__/sensor_fb";
		sia81xx_L = "/fragment@6/__overlay__/sia81xx@L";
		sia81xx_gpio_L = "/fragment@5/__overlay__/sia81xx_gpio_L";
		sia81xx_id_L = "/fragment@5/__overlay__/sia81xx_id_L";
		spk = "/fragment@58/__overlay__/speaker_amp@5c";
		sub_bat_temp_ntc = "/fragment@66/__overlay__/sub_bat_temp_ntc";
		svp = "/fragment@65/__overlay__/SecureVideoPath";
		uart0_rx_gpio_input = "/fragment@33/__overlay__/uart0_rx_gpio@gpio28";
		uart0_tx_gpio_input = "/fragment@33/__overlay__/uart0_tx_gpio@gpio29";
		usb_c_pinctrl = "/fragment@36/__overlay__/usb_c_pinctrl";
		vibrator0 = "/fragment@36/__overlay__/vibrator@0";
		volume_down_gpio_eint = "/fragment@64/__overlay__/volume_down@0";
	};

	fragment@0 {
		target = <0xffffffff>;

		__overlay__ {

			cam0@0 {
				phandle = <0x2>;

				pins_cmd_dat {
					output-low;
					pinmux = <0x1200>;
					slew-rate = <0x1>;
				};
			};

			cam0@1 {
				phandle = <0x3>;

				pins_cmd_dat {
					output-high;
					pinmux = <0x1200>;
					slew-rate = <0x1>;
				};
			};

			cam1@0 {
				phandle = <0x4>;

				pins_cmd_dat {
					output-low;
					pinmux = <0x1000>;
					slew-rate = <0x1>;
				};
			};

			cam1@1 {
				phandle = <0x5>;

				pins_cmd_dat {
					output-high;
					pinmux = <0x1000>;
					slew-rate = <0x1>;
				};
			};

			cam1@2 {
				phandle = <0x17>;

				pins_cmd_dat {
					output-low;
					pinmux = <0x8a00>;
					slew-rate = <0x1>;
				};

				pins_cmd_dat1 {
					output-low;
					pinmux = <0x8b00>;
					slew-rate = <0x1>;
				};
			};

			cam1@3 {
				phandle = <0x18>;

				pins_cmd_dat {
					bias-pull-up;
					pinmux = <0x8a01>;
					slew-rate = <0x0>;
				};

				pins_cmd_dat1 {
					bias-pull-up;
					pinmux = <0x8b01>;
					slew-rate = <0x0>;
				};
			};

			cam2@0 {
				phandle = <0x6>;

				pins_cmd_dat {
					output-low;
					pinmux = <0x1600>;
					slew-rate = <0x1>;
				};
			};

			cam2@1 {
				phandle = <0x7>;

				pins_cmd_dat {
					output-high;
					pinmux = <0x1600>;
					slew-rate = <0x1>;
				};
			};

			cam2@2 {
				phandle = <0x19>;

				pins_cmd_dat {
					output-low;
					pinmux = <0x8a00>;
					slew-rate = <0x1>;
				};

				pins_cmd_dat1 {
					output-low;
					pinmux = <0x8b00>;
					slew-rate = <0x1>;
				};
			};

			cam2@3 {
				phandle = <0x1a>;

				pins_cmd_dat {
					bias-pull-up;
					pinmux = <0x8a01>;
					slew-rate = <0x0>;
				};

				pins_cmd_dat1 {
					bias-pull-up;
					pinmux = <0x8b01>;
					slew-rate = <0x0>;
				};
			};

			camdefault {
				phandle = <0x1>;
			};

			camera_pins_cam0_mclk_2ma {
				phandle = <0x9>;

				pins_cmd_dat {
					drive-strength = <0x0>;
					pinmux = <0x7f01>;
				};
			};

			camera_pins_cam0_mclk_4ma {
				phandle = <0xa>;

				pins_cmd_dat {
					drive-strength = <0x1>;
					pinmux = <0x7f01>;
				};
			};

			camera_pins_cam0_mclk_6ma {
				phandle = <0xb>;

				pins_cmd_dat {
					drive-strength = <0x2>;
					pinmux = <0x7f01>;
				};
			};

			camera_pins_cam0_mclk_8ma {
				phandle = <0xc>;

				pins_cmd_dat {
					drive-strength = <0x3>;
					pinmux = <0x7f01>;
				};
			};

			camera_pins_cam0_mclk_off {
				phandle = <0x8>;

				pins_cmd_dat {
					drive-strength = <0x1>;
					pinmux = <0x7f00>;
				};
			};

			camera_pins_cam1_mclk_2ma {
				phandle = <0xe>;

				pins_cmd_dat {
					drive-strength = <0x0>;
					pinmux = <0x7e01>;
				};
			};

			camera_pins_cam1_mclk_4ma {
				phandle = <0xf>;

				pins_cmd_dat {
					drive-strength = <0x1>;
					pinmux = <0x7e01>;
				};
			};

			camera_pins_cam1_mclk_6ma {
				phandle = <0x10>;

				pins_cmd_dat {
					drive-strength = <0x2>;
					pinmux = <0x7e01>;
				};
			};

			camera_pins_cam1_mclk_8ma {
				phandle = <0x11>;

				pins_cmd_dat {
					drive-strength = <0x3>;
					pinmux = <0x7e01>;
				};
			};

			camera_pins_cam1_mclk_off {
				phandle = <0xd>;

				pins_cmd_dat {
					drive-strength = <0x1>;
					pinmux = <0x7e00>;
				};
			};

			camera_pins_cam2_mclk_2ma {
				phandle = <0x13>;

				pins_cmd_dat {
					drive-strength = <0x0>;
					pinmux = <0x8101>;
				};
			};

			camera_pins_cam2_mclk_4ma {
				phandle = <0x14>;

				pins_cmd_dat {
					drive-strength = <0x1>;
					pinmux = <0x8101>;
				};
			};

			camera_pins_cam2_mclk_6ma {
				phandle = <0x15>;

				pins_cmd_dat {
					drive-strength = <0x2>;
					pinmux = <0x8101>;
				};
			};

			camera_pins_cam2_mclk_8ma {
				phandle = <0x16>;

				pins_cmd_dat {
					drive-strength = <0x3>;
					pinmux = <0x8101>;
				};
			};

			camera_pins_cam2_mclk_off {
				phandle = <0x12>;

				pins_cmd_dat {
					drive-strength = <0x1>;
					pinmux = <0x8100>;
				};
			};
		};
	};

	fragment@1 {
		target = <0xffffffff>;

		__overlay__ {
			cam0_enable_sensor = "s5kjn1_mipi_raw_doki";
			cam0_pin_mclk = "mclk";
			cam0_pin_rst = "gpio";
			cam0_pin_vcama = "wl2868c";
			cam0_pin_vcamaf = "wl2868c";
			cam0_pin_vcamd = "wl2868c";
			cam0_pin_vcamio = "wl2868c";
			cam1_enable_sensor = "ov16a1q_mipi_raw_doki";
			cam1_pin_mclk = "mclk";
			cam1_pin_rst = "gpio";
			cam1_pin_vcama = "wl2868c";
			cam1_pin_vcama1 = "gpio";
			cam1_pin_vcamd = "wl2868c";
			cam1_pin_vcamio = "wl2868c";
			cam2_enable_sensor = "ov02b1b_mipi_mono_doki sc201cs_mipi_mono_doki";
			cam2_pin_mclk = "mclk";
			cam2_pin_rst = "gpio";
			cam2_pin_vcama = "wl2868c";
			cam2_pin_vcama1 = "gpio";
			cam2_pin_vcamio = "wl2868c";
			pinctrl-0 = <0x1>;
			pinctrl-1 = <0x2>;
			pinctrl-10 = <0xb>;
			pinctrl-11 = <0xc>;
			pinctrl-12 = <0xd>;
			pinctrl-13 = <0xe>;
			pinctrl-14 = <0xf>;
			pinctrl-15 = <0x10>;
			pinctrl-16 = <0x11>;
			pinctrl-17 = <0x12>;
			pinctrl-18 = <0x13>;
			pinctrl-19 = <0x14>;
			pinctrl-2 = <0x3>;
			pinctrl-20 = <0x15>;
			pinctrl-21 = <0x16>;
			pinctrl-22 = <0x17>;
			pinctrl-23 = <0x18>;
			pinctrl-24 = <0x19>;
			pinctrl-25 = <0x1a>;
			pinctrl-3 = <0x4>;
			pinctrl-4 = <0x5>;
			pinctrl-5 = <0x6>;
			pinctrl-6 = <0x7>;
			pinctrl-7 = <0x8>;
			pinctrl-8 = <0x9>;
			pinctrl-9 = <0xa>;
			pinctrl-names = "default", "cam0_rst0", "cam0_rst1", "cam1_rst0", "cam1_rst1", "cam2_rst0", "cam2_rst1", "cam0_mclk_off", "cam0_mclk_2mA", "cam0_mclk_4mA", "cam0_mclk_6mA", "cam0_mclk_8mA", "cam1_mclk_off", "cam1_mclk_2mA", "cam1_mclk_4mA", "cam1_mclk_6mA", "cam1_mclk_8mA", "cam2_mclk_off", "cam2_mclk_2mA", "cam2_mclk_4mA", "cam2_mclk_6mA", "cam2_mclk_8mA", "cam1_ldo_vcama1_0", "cam1_ldo_vcama1_1", "cam2_ldo_vcama1_0", "cam2_ldo_vcama1_1";
			status = "okay";
		};
	};

	fragment@10 {
		target = <0xffffffff>;

		__overlay__ {
			charger = <0x21>;
			gauge = <0xffffffff>;
			io-channel-names = "auxadc5temp", "usb_temp_v_l", "usb_temp_v_r";
			io-channels = <0xffffffff 0x5 0xffffffff 0x2 0xffffffff 0x3>;
			pinctrl-0 = <0x22>;
			pinctrl-1 = <0x23>;
			pinctrl-2 = <0x24>;
			pinctrl-3 = <0x25>;
			pinctrl-4 = <0x26>;
			pinctrl-5 = <0x27>;
			pinctrl-names = "charger_gpio_as_output_low", "charger_gpio_as_output_high", "ccdetect_active", "ccdetect_sleep", "dischg_enable", "dischg_disable";
			qcom,batt_capacity_mah = <0x1388>;
			qcom,ccdetect_by_wd0;
			qcom,charger_hv_thr = <0x2710>;
			qcom,charger_lv_thr = <0xd48>;
			qcom,charger_recv_thr = <0x2648>;
			qcom,chargerid_support;
			qcom,chargerid_switch-gpio = <0xffffffff 0x97 0x0>;
			qcom,chargerid_vol_disable;
			qcom,check_batt_full_by_sw;
			qcom,chg_ctrl_by_calling;
			qcom,chg_ctrl_by_camera;
			qcom,chg_ctrl_by_lcd;
			qcom,cold_bat_decidegc = <0x64>;
			qcom,cold_vfloat_over_sw_limit = <0x115d>;
			qcom,cold_vfloat_sw_limit = <0x1121>;
			qcom,cool_bat_decidegc = <0x32>;
			qcom,cool_vfloat_over_sw_limit = <0x115d>;
			qcom,cool_vfloat_sw_limit = <0x1121>;
			qcom,default_iterm_ma = <0xff>;
			qcom,default_little_cool_vfloat_over_sw_limit = <0x115d>;
			qcom,default_little_cool_vfloat_sw_limit = <0x1121>;
			qcom,default_normal_vfloat_over_sw_limit = <0x115d>;
			qcom,default_normal_vfloat_sw_limit = <0x1121>;
			qcom,default_temp_little_cool_fastchg_current_ma = <0x898>;
			qcom,default_temp_little_cool_vfloat_mv = <0x1153>;
			qcom,default_temp_normal_fastchg_current_ma = <0x898>;
			qcom,default_temp_normal_vfloat_mv = <0x1153>;
			qcom,dischg-gpio = <0xffffffff 0x9c 0x0>;
			qcom,ff1_exit_step_ma = <0x190>;
			qcom,ff1_normal_fastchg_ma = <0x5dc>;
			qcom,ff1_warm_exit_step_ma = <0x12c>;
			qcom,ff1_warm_fastchg_ma = <0x5dc>;
			qcom,ffc2_exit_step_ma = <0x64>;
			qcom,ffc2_normal_fastchg_ma = <0x4b0>;
			qcom,ffc2_normal_vfloat_over_sw_limit = <0x11c6>;
			qcom,ffc2_normal_vfloat_sw_limit = <0x117b>;
			qcom,ffc2_temp_high_decidegc = <0x190>;
			qcom,ffc2_temp_low_decidegc = <0x78>;
			qcom,ffc2_temp_normal_vfloat_mv = <0x11c6>;
			qcom,ffc2_temp_warm_decidegc = <0x15e>;
			qcom,ffc2_warm_exit_step_ma = <0x64>;
			qcom,ffc2_warm_fastchg_ma = <0x514>;
			qcom,ffc2_warm_vfloat_sw_limit = <0x117b>;
			qcom,ffc_normal_vfloat_over_sw_limit = <0x11c6>;
			qcom,ffc_normal_vfloat_sw_limit = <0x117b>;
			qcom,ffc_support;
			qcom,ffc_temp_normal_vfloat_mv = <0x11c6>;
			qcom,ffc_warm_vfloat_sw_limit = <0x117b>;
			qcom,hot_bat_decidegc = <0x212>;
			qcom,hvdcp_disabled;
			qcom,input_current_calling_ma = <0x5dc>;
			qcom,input_current_camera_ma = <0x4b0>;
			qcom,input_current_cdp_ma = <0x5dc>;
			qcom,input_current_charger_ma = <0x898>;
			qcom,input_current_led_ma = <0x4b0>;
			qcom,input_current_led_ma_forcmcc = <0x1f4>;
			qcom,input_current_led_ma_high = <0x4b0>;
			qcom,input_current_led_ma_limit_high = <0x4b0>;
			qcom,input_current_led_ma_normal = <0x7d0>;
			qcom,input_current_led_ma_warm = <0x5dc>;
			qcom,input_current_usb_ma = <0x1f4>;
			qcom,input_current_vooc_led_ma_high = <0x4b0>;
			qcom,input_current_vooc_led_ma_normal = <0xe10>;
			qcom,input_current_vooc_led_ma_warm = <0x708>;
			qcom,input_current_vooc_ma_high = <0x898>;
			qcom,input_current_vooc_ma_normal = <0xe10>;
			qcom,input_current_vooc_ma_warm = <0xc80>;
			qcom,iterm_disabled = <0x0>;
			qcom,iterm_ma = <0xff>;
			qcom,led_high_bat_decidegc = <0x172>;
			qcom,led_warm_bat_decidegc = <0x15e>;
			qcom,little_cold_bat_decidegc = <0x0>;
			qcom,little_cold_vfloat_over_sw_limit = <0x115d>;
			qcom,little_cold_vfloat_sw_limit = <0x1121>;
			qcom,little_cool_bat_decidegc = <0x78>;
			qcom,little_cool_vfloat_over_sw_limit = <0x115d>;
			qcom,little_cool_vfloat_sw_limit = <0x1121>;
			qcom,max_chg_time_sec = <0x11940>;
			qcom,new_ui_warning_support;
			qcom,non_normal_vterm_hw_inc = <0x12>;
			qcom,non_standard_fastchg_current_ma = <0x200>;
			qcom,non_standard_vfloat_mv = <0xf8c>;
			qcom,non_standard_vfloat_over_sw_limit = <0xf96>;
			qcom,non_standard_vfloat_sw_limit = <0xf5a>;
			qcom,normal_bat_decidegc = <0xa0>;
			qcom,normal_vfloat_over_sw_limit = <0x1158>;
			qcom,normal_vfloat_sw_limit = <0x1121>;
			qcom,normal_vterm_hw_inc = <0x12>;
			qcom,overtemp_bat_decidegc = <0x15e>;
			qcom,pd_input_current_charger_ma = <0x7d0>;
			qcom,pd_temp_cool_fastchg_current_ma_high = <0xce4>;
			qcom,pd_temp_cool_fastchg_current_ma_low = <0xce4>;
			qcom,pd_temp_little_cold_fastchg_current_ma_high = <0xa22>;
			qcom,pd_temp_little_cold_fastchg_current_ma_low = <0xce4>;
			qcom,pd_temp_little_cool_fastchg_current_ma = <0xce4>;
			qcom,pd_temp_normal_fastchg_current_ma = <0xce4>;
			qcom,pd_temp_warm_fastchg_current_ma = <0x514>;
			qcom,qc_input_current_charger_ma = <0x7d0>;
			qcom,qc_temp_cool_fastchg_current_ma_high = <0xce4>;
			qcom,qc_temp_cool_fastchg_current_ma_low = <0xce4>;
			qcom,qc_temp_little_cold_fastchg_current_ma_high = <0xa22>;
			qcom,qc_temp_little_cold_fastchg_current_ma_low = <0xce4>;
			qcom,qc_temp_little_cool_fastchg_current_ma = <0xce4>;
			qcom,qc_temp_normal_fastchg_current_ma = <0xce4>;
			qcom,qc_temp_warm_fastchg_current_ma = <0x514>;
			qcom,recharge-mv = <0x64>;
			qcom,removed_bat_decidegc = <0x96>;
			qcom,short_c_bat_cv_mv = <0x10ea>;
			qcom,short_c_bat_fastchg_current_ma = <0x200>;
			qcom,short_c_bat_vfloat_mv = <0xed8>;
			qcom,short_c_bat_vfloat_sw_limit = <0xea6>;
			qcom,smart_charge_version = <0x1>;
			qcom,smart_charging_screenoff;
			qcom,support_ntc_01c_precision;
			qcom,sw_vfloat_over_protect_enable;
			qcom,temp_cold_fastchg_current_ma = <0x384>;
			qcom,temp_cold_vfloat_mv = <0x1153>;
			qcom,temp_cool_fastchg_current_ma_high = <0x898>;
			qcom,temp_cool_fastchg_current_ma_low = <0x898>;
			qcom,temp_cool_vfloat_mv = <0x1153>;
			qcom,temp_freeze_fastchg_current_ma = <0x384>;
			qcom,temp_freeze_fastchg_current_ma_high = <0x384>;
			qcom,temp_freeze_fastchg_current_ma_low = <0x384>;
			qcom,temp_little_cold_fastchg_current_ma = <0x898>;
			qcom,temp_little_cold_fastchg_current_ma_high = <0x898>;
			qcom,temp_little_cold_fastchg_current_ma_low = <0x898>;
			qcom,temp_little_cold_vfloat_mv = <0x1153>;
			qcom,temp_little_cool_fastchg_current_ma = <0x898>;
			qcom,temp_little_cool_vfloat_mv = <0x1153>;
			qcom,temp_normal_fastchg_current_ma = <0x898>;
			qcom,temp_normal_vfloat_mv = <0x1153>;
			qcom,temp_warm_fastchg_current_ma = <0x514>;
			qcom,temp_warm_fastchg_current_ma_led_on = <0x1f4>;
			qcom,temp_warm_vfloat_mv = <0x1022>;
			qcom,ui_soc_decimal_speedmin = <0x14>;
			qcom,usb_high_than_bat_decidegc = <0xa8>;
			qcom,usbtemp_batttemp_gap = <0xc>;
			qcom,usbtemp_dischg_by_platpmic;
			qcom,vbatt_full_thr = <0x1130>;
			qcom,vbatt_hv_thr = <0x11f8>;
			qcom,vbatt_num = <0x1>;
			qcom,vbatt_pdqc_to_5v_thr = <0x1194>;
			qcom,vbatt_pdqc_to_9v_thr = <0x1194>;
			qcom,vbatt_power_off = <0xce4>;
			qcom,vbatt_soc_1 = <0xd52>;
			qcom,vfloat_step_mv = <0x10>;
			qcom,vooc-max-input-current-support = <0xbb8>;
			qcom,vooc-max-input-volt-support = <0x2710>;
			qcom,vooc_project = <0x5>;
			qcom,vooc_show_ui_soc_decimal;
			qcom,vooc_temp_bat_hot_decidegc = <0x1b8>;
			qcom,vooc_temp_bat_normal_decidegc = <0x15e>;
			qcom,vooc_temp_bat_warm_decidegc = <0x172>;
			qcom,voocphy_support = <0x2>;
			qcom,warm_bat_decidegc = <0x1c2>;
			qcom,warm_vfloat_over_sw_limit = <0x102c>;
			qcom,warm_vfloat_sw_limit = <0xff0>;
		};
	};

	fragment@11 {
		target = <0xffffffff>;

		__overlay__ {
			ac_charger_current = <0x1f47d0>;
			ac_charger_input_current = <0x16e360>;
			boot_battery_voltage = <0x33e140>;
			charger_no_wiress;
			charging_host_charger_current = <0x16e360>;
			max_charger_voltage = <0xe4e1c0>;
			non_std_ac_charger_current = <0xb71b0>;
			pd_charger_current = <0x7a120>;
			support_sdp_backlight;
			support_sdp_screenoff;
			support_tuv_authentication;
			ta_ac_charger_current = <0x16e360>;
			usb_charger_current = <0x7a120>;
		};
	};

	fragment@12 {
		target = <0xffffffff>;

		__overlay__ {
			status = "okay";

			sc8547-charger@6F {
				compatible = "sc,sc8547-master";
				interrupt-parent = <0xffffffff>;
				interrupts = <0xc 0x0>;
				pinctrl-0 = <0x28>;
				pinctrl-1 = <0x29>;
				pinctrl-2 = <0x2a>;
				pinctrl-3 = <0x2b>;
				pinctrl-names = "switch1_act_switch2_act", "switch1_sleep_switch2_sleep", "charging_inter_active", "charging_inter_sleep";
				qcom,charging_switch1-gpio = <0xffffffff 0x9b 0x0>;
				qcom,irq_gpio = <0xffffffff 0xc 0x0>;
				qcom,low_curr_full_t1 = <0x78>;
				qcom,low_curr_full_t2 = <0x15e>;
				qcom,low_curr_full_t3 = <0x1ae>;
				qcom,range1_low_curr_full = <0x44c 0x1176 0x3e8 0x116c 0x384 0x1162>;
				qcom,range2_low_curr_full = <0x4b0 0x1176 0x44c 0x116c 0x3e8 0x1162>;
				qcom,slave_cp_disable_thr_high = <0x640>;
				qcom,slave_cp_enable_thr = <0x76c>;
				qcom,svooc_cool_down_current_limit = <0x3c 0x14 0x14 0x14 0x1e 0x28 0x32 0x3c 0x3c 0x3c 0x3c 0x3c 0x3c 0x3c 0x3c>;
				qcom,vooc-high-soc = <0x5a>;
				qcom,vooc-high-temp = <0x1f4>;
				qcom,vooc-low-soc = <0x0>;
				qcom,vooc-low-temp = <0x0>;
				qcom,vooc-normal-high-temp = <0x1b8>;
				qcom,vooc-warm-allow-soc = <0x32>;
				qcom,vooc-warm-allow-vol = <0xfa0>;
				qcom,vooc_1time_full_voltage = <0x1184>;
				qcom,vooc_batt_over_high_temp = <0x1f4>;
				qcom,vooc_cool_down_current_limit = <0x1e 0x14 0x14 0x14 0x1e 0x1e 0x1e 0x1e 0x1e 0x1e 0x1e 0x1e 0x1e 0x1e 0x1e>;
				qcom,vooc_cool_full_voltage = <0x1152>;
				qcom,vooc_cool_temp = <0x78>;
				qcom,vooc_little_cold_full_voltage = <0x1152>;
				qcom,vooc_little_cold_temp = <0x32>;
				qcom,vooc_little_cool_temp = <0xa0>;
				qcom,vooc_multistep_initial_batt_temp = <0x3e8>;
				qcom,vooc_normal_low_temp = <0xfa>;
				qcom,vooc_normal_to_little_cool_current = <0x64>;
				qcom,vooc_ntime_full_voltage = <0x1184>;
				qcom,vooc_strategy1_batt_high_temp0 = <0x190>;
				qcom,vooc_strategy1_batt_high_temp1 = <0x1a4>;
				qcom,vooc_strategy1_batt_high_temp2 = <0x1ae>;
				qcom,vooc_strategy1_batt_low_temp0 = <0x186>;
				qcom,vooc_strategy1_batt_low_temp1 = <0x19a>;
				qcom,vooc_strategy1_batt_low_temp2 = <0x1a4>;
				qcom,vooc_strategy1_high_current0 = <0x28>;
				qcom,vooc_strategy1_high_current1 = <0x1e>;
				qcom,vooc_strategy1_high_current2 = <0x14>;
				qcom,vooc_strategy1_low_current0 = <0x3c>;
				qcom,vooc_strategy1_low_current1 = <0x32>;
				qcom,vooc_strategy1_low_current2 = <0x28>;
				qcom,vooc_strategy_normal_current = <0x64>;
				qcom,vooc_warm_full_voltage = <0x1022>;
				qcom,voocphy_cp_max_ibus = <0xdac>;
				qcom,voocphy_current_change_timeout = <0x64>;
				qcom,voocphy_current_default = <0x3c>;
				qcom,voocphy_freq_maxcore = <0x1b7740>;
				qcom,voocphy_freq_midcore = <0x1b7740>;
				qcom,voocphy_freq_mincore = <0x1b7740>;
				qcom,voocphy_ibat_over_current = <0x1d4c>;
				qcom,voocphy_svooc_cp_max_ibus = <0xdac>;
				qcom,voocphy_vooc_cp_max_ibus = <0xdac>;
				reg = <0x6f 0x0>;
				status = "okay";
				svooc_batt_sys_curve = <0x0 0x1 0x0 0x1 0x0 0x0 0x0 0x1 0x1 0x1 0x1 0x0 0x0 0x0 0x0 0x0 0x1 0x1 0x0 0x1 0x0 0x1 0x1 0x1 0x1 0x0 0x0 0x0 0x0 0x0 0x0 0x1 0x0 0x1 0x1 0x1 0x1 0x1 0x1 0x0 0x0 0x0>;
				vooc_batt_sys_curve = <0x0 0x1 0x0 0x1 0x0 0x0 0x0 0x1 0x1 0x1 0x1 0x0 0x0 0x0 0x0 0x0 0x1 0x1 0x0 0x1 0x0 0x1 0x1 0x1 0x1 0x0 0x0 0x0 0x0 0x0 0x0 0x1 0x0 0x1 0x1 0x1 0x1 0x1 0x1 0x0 0x0 0x0>;

				svooc_charge_strategy {

					strategy_soc_0_to_50 {
						strategy_temp_cool = <0x1058 0x14 0x0 0x0 0x0 0x1148 0xf 0x0 0x0 0x0 0x1152 0xa 0x1 0x0 0x0>;
						strategy_temp_little_cold = <0x1058 0xf 0x0 0x0 0x0 0x1152 0xa 0x1 0x0 0x0>;
						strategy_temp_little_cool = <0x1166 0x14 0x0 0x0 0x0 0x117a 0xf 0x0 0x0 0x0 0x1184 0xa 0x1 0x0 0x0>;
						strategy_temp_normal_high = <0x1068 0x1e 0x0 0x4b0 0x0 0x1166 0x19 0x0 0x4b0 0x0 0x1166 0x17 0x0 0x0 0x0 0x1166 0x14 0x0 0x0 0x0 0x117a 0x11 0x0 0x0 0x0 0x117a 0xf 0x0 0x0 0x0 0x1184 0xa 0x1 0x0 0x0>;
						strategy_temp_normal_low = <0x1068 0x1e 0x0 0x4b0 0x0 0x1166 0x19 0x0 0x4b0 0x0 0x1166 0x17 0x0 0x0 0x0 0x1166 0x14 0x0 0x0 0x0 0x117a 0x11 0x0 0x0 0x0 0x117a 0xf 0x0 0x0 0x0 0x1184 0xa 0x1 0x0 0x0>;
						strategy_temp_warm = <0x1022 0xa 0x1 0x0 0x0>;
					};

					strategy_soc_50_to_75 {
						strategy_temp_cool = <0x1090 0x14 0x0 0x0 0x0 0x1090 0xf 0x0 0x0 0x0 0x114e 0xa 0x1 0x0 0x0>;
						strategy_temp_little_cold = <0x1068 0xf 0x0 0x0 0x0 0x114e 0xa 0x1 0x0 0x0>;
						strategy_temp_little_cool = <0x1166 0x14 0x0 0x0 0x0 0x117a 0xf 0x0 0x0 0x0 0x1184 0xa 0x1 0x0 0x0>;
						strategy_temp_normal_high = <0x1068 0x1e 0x0 0x4b0 0x0 0x1166 0x19 0x0 0x4b0 0x0 0x1166 0x17 0x0 0x0 0x0 0x1166 0x14 0x0 0x0 0x0 0x117a 0x11 0x0 0x0 0x0 0x117a 0xf 0x0 0x0 0x0 0x1184 0xa 0x1 0x0 0x0>;
						strategy_temp_normal_low = <0x1068 0x1e 0x0 0x4b0 0x0 0x1166 0x19 0x0 0x4b0 0x0 0x1166 0x17 0x0 0x0 0x0 0x1166 0x14 0x0 0x0 0x0 0x117a 0x11 0x0 0x0 0x0 0x117a 0xf 0x0 0x0 0x0 0x1184 0xa 0x1 0x0 0x0>;
						strategy_temp_warm = <0x1022 0xa 0x1 0x0 0x0>;
					};

					strategy_soc_75_to_85 {
						strategy_temp_cool = <0x114e 0xa 0x1 0x0 0x0>;
						strategy_temp_little_cold = <0x114e 0xa 0x1 0x0 0x0>;
						strategy_temp_little_cool = <0x1180 0xa 0x1 0x0 0x0>;
						strategy_temp_normal_high = <0x1180 0xa 0x1 0x0 0x0>;
						strategy_temp_normal_low = <0x1180 0xa 0x1 0x0 0x0>;
						strategy_temp_warm = <0x1022 0xa 0x1 0x0 0x0>;
					};

					strategy_soc_85_to_90 {
						strategy_temp_cool = <0x114e 0xa 0x1 0x0 0x0>;
						strategy_temp_little_cold = <0x114e 0xa 0x1 0x0 0x0>;
						strategy_temp_little_cool = <0x1180 0xa 0x1 0x0 0x0>;
						strategy_temp_normal_high = <0x1180 0xa 0x1 0x0 0x0>;
						strategy_temp_normal_low = <0x1180 0xa 0x1 0x0 0x0>;
						strategy_temp_warm = <0x1022 0xa 0x1 0x0 0x0>;
					};
				};

				vooc_charge_strategy {

					strategy_soc_0_to_50 {
						strategy_temp_cool = <0x1144 0x1e 0x0 0x0 0x0 0x114e 0x14 0x1 0x0 0x0>;
						strategy_temp_little_cold = <0x114e 0x14 0x1 0x0 0x0>;
						strategy_temp_little_cool = <0x117b 0x1e 0x0 0x0 0x0 0x1180 0x14 0x1 0x0 0x0>;
						strategy_temp_normal_high = <0x117b 0x1e 0x0 0x0 0x0 0x1180 0x14 0x1 0x0 0x0>;
						strategy_temp_normal_low = <0x117b 0x1e 0x0 0x0 0x0 0x1180 0x14 0x1 0x0 0x0>;
						strategy_temp_warm = <0x1022 0x14 0x1 0x0 0x0>;
					};

					strategy_soc_50_to_75 {
						strategy_temp_cool = <0x1144 0x1e 0x0 0x0 0x0 0x114e 0x14 0x1 0x0 0x0>;
						strategy_temp_little_cold = <0x114e 0x14 0x1 0x0 0x0>;
						strategy_temp_little_cool = <0x117b 0x1e 0x0 0x0 0x0 0x1180 0x14 0x1 0x0 0x0>;
						strategy_temp_normal_high = <0x117b 0x1e 0x0 0x0 0x0 0x1180 0x14 0x1 0x0 0x0>;
						strategy_temp_normal_low = <0x117b 0x1e 0x0 0x0 0x0 0x1180 0x14 0x1 0x0 0x0>;
						strategy_temp_warm = <0x1022 0x14 0x1 0x0 0x0>;
					};

					strategy_soc_75_to_85 {
						strategy_temp_cool = <0x114e 0x14 0x1 0x0 0x0>;
						strategy_temp_little_cold = <0x114e 0x14 0x1 0x0 0x0>;
						strategy_temp_little_cool = <0x1180 0x14 0x1 0x0 0x0>;
						strategy_temp_normal_high = <0x117b 0x1e 0x0 0x0 0x0 0x1180 0x14 0x1 0x0 0x0>;
						strategy_temp_normal_low = <0x117b 0x1e 0x0 0x0 0x0 0x1180 0x14 0x1 0x0 0x0>;
						strategy_temp_warm = <0x1022 0x14 0x1 0x0 0x0>;
					};

					strategy_soc_85_to_90 {
						strategy_temp_cool = <0x114e 0x14 0x1 0x0 0x0>;
						strategy_temp_little_cold = <0x114e 0x14 0x1 0x0 0x0>;
						strategy_temp_little_cool = <0x1180 0x14 0x1 0x0 0x0>;
						strategy_temp_normal_high = <0x1180 0x14 0x1 0x0 0x0>;
						strategy_temp_normal_low = <0x1180 0x14 0x1 0x0 0x0>;
						strategy_temp_warm = <0x1022 0x14 0x1 0x0 0x0>;
					};
				};
			};
		};
	};

	fragment@13 {
		target = <0xffffffff>;

		__overlay__ {
			status = "okay";

			sc8547-charger-slave@6F {
				compatible = "sc,sc8547-slave";
				reg = <0x6f 0x0>;
				status = "disabled";
			};
		};
	};

	fragment@14 {
		target = <0xffffffff>;

		__overlay__ {
			status = "disabled";
		};
	};

	fragment@15 {
		target = <0xffffffff>;

		__overlay__ {

			ccdetect_active {
				phandle = <0x24>;

				pins_cmd_dat {
					output-high;
					pinmux = <0x300>;
				};
			};

			ccdetect_sleep {
				phandle = <0x25>;

				pins_cmd_dat {
					output-low;
					pinmux = <0x300>;
				};
			};

			charger_gpio_as_output_high {
				phandle = <0x23>;

				pins_cmd_dat {
					output-high;
					pinmux = <0x9700>;
				};
			};

			charger_gpio_as_output_low {
				phandle = <0x22>;

				pins_cmd_dat {
					output-low;
					pinmux = <0x9700>;
				};
			};

			charging_inter_active {
				phandle = <0x2a>;

				pins_cmd_dat {
					pinmux = <0xc00>;
					slew-rate = <0x0>;
				};
			};

			charging_inter_sleep {
				phandle = <0x2b>;

				pins_cmd_dat {
					pinmux = <0xc00>;
					slew-rate = <0x0>;
				};
			};

			charging_switch1_active {
				phandle = <0x28>;

				pins_cmd_dat {
					output-high;
					pinmux = <0x9b00>;
				};
			};

			charging_switch1_sleep {
				phandle = <0x29>;

				pins_cmd_dat {
					output-low;
					pinmux = <0x9b00>;
				};
			};

			dischg_disable {
				phandle = <0x27>;

				pins_cmd_dat {
					output-low;
					pinmux = <0x9c00>;
				};
			};

			dischg_enable {
				phandle = <0x26>;

				pins_cmd_dat {
					output-high;
					pinmux = <0x9c00>;
				};
			};
		};
	};

	fragment@16 {
		target = <0xffffffff>;

		__overlay__ {
			max-volt = <0x2dc6c0>;
			min-volt = <0x2dc6c0>;
		};
	};

	fragment@17 {
		target = <0xffffffff>;

		__overlay__ {
			charger = <0x21>;
			status = "okay";
		};
	};

	fragment@18 {
		target = <0xffffffff>;

		__overlay__ {
			charger = <0x21>;
			status = "okay";
		};
	};

	fragment@19 {
		target = <0xffffffff>;

		__overlay__ {
			charger = <0x21>;
			status = "okay";
		};
	};

	fragment@2 {
		target = <0xffffffff>;

		__overlay__ {
			#address-cells = <0x1>;
			#size-cells = <0x0>;
			clock-frequency = <0x61a80>;
			status = "okay";

			camera_eeprom0@11 {
				compatible = "mediatek,camera_eeprom";
				phandle = <0x5b>;
				reg = <0x11>;
				status = "okay";
			};

			camera_main@5a {
				#thermal-sensor-cells = <0x0>;
				compatible = "mediatek,camera_main";
				phandle = <0x1b>;
				reg = <0x5a>;
				status = "okay";
			};

			camera_main_af@18 {
				compatible = "mediatek,camera_main_af";
				phandle = <0x5c>;
				reg = <0x18>;
				status = "okay";
			};
		};
	};

	fragment@20 {
		target = <0xffffffff>;

		__overlay__ {
			charger = <0x21>;
			status = "okay";
		};
	};

	fragment@21 {
		target = <0xffffffff>;

		__overlay__ {
			charger = <0x21>;
			status = "okay";
		};
	};

	fragment@22 {
		target = <0xffffffff>;

		__overlay__ {

			oplus,track-charge {
				compatible = "oplus,track-charge";
				track,fast_chg_break_t_thd = <0x3e8>;
				track,general_chg_break_t_thd = <0xc8>;
				track,voocphy_type = <0x2>;
				track,wired_fast_chg_scheme = <0x4>;
				track,wired_max_power = <0x80e8>;
			};

			optiga {
				compatible = "oplus-optiga";
				cpu-id = <0x7>;
				data-gpio = <0xffffffff 0x36 0x0>;
				key-id = <0x1>;
				pinctrl-0 = <0x2c>;
				pinctrl-names = "optiga_active";
				status = "ok";
			};
		};
	};

	fragment@23 {
		target = <0xffffffff>;

		__overlay__ {

			optiga_active {
				phandle = <0x2c>;

				pins_cmd_dat {
					bias-disable;
					pinmux = <0x3600>;
				};
			};
		};
	};

	fragment@24 {
		target = <0xffffffff>;

		__overlay__ {

			oplus_sensor {
				als-row-coe = <0x3e8>;
				compatible = "oplus,sensor-devinfo";
				phandle = <0x62>;

				alsps_arch {
					new-arch-supported = <0x1>;
					phandle = <0x6c>;
					status = "okay";
				};

				cali_arch {
					new-arch-supported = <0x1>;
					phandle = <0x6d>;
					status = "okay";
				};

				gsensor_1 {
					acc_cali_range = <0xc8 0xc8 0xc8>;
					device_name = "sc7a20";
					direction = <0x4>;
					eint_num = <0x2>;
					gyro_cali_version = <0x2>;
					i2c_addr = <0x0>;
					i2c_num = <0x1>;
					phandle = <0x63>;
					sensor_name = <0x9>;
					status = "okay";
				};

				gsensor_2 {
					acc_cali_range = <0xc8 0xc8 0xc8>;
					device_name = "mc34x9";
					direction = <0x7>;
					eint_num = <0x2>;
					gyro_cali_version = <0x2>;
					i2c_addr = <0x0>;
					i2c_num = <0x1>;
					phandle = <0x64>;
					sensor_name = <0xa>;
					status = "okay";
				};

				light_1 {
					als_buffer_length = <0xa>;
					als_ratio = <0x6e>;
					als_type = <0x2>;
					device_name = "tcs3701";
					direction = <0x4>;
					eint_num = <0xb>;
					i2c_addr = <0x39>;
					i2c_num = <0x0>;
					phandle = <0x69>;
					sensor_name = <0x5>;
					status = "okay";
				};

				lux_aod {
					phandle = <0x6b>;
					status = "okay";
					use-proximity = <0x1>;
				};

				msensor_1 {
					direction = <0x0>;
					eint_num = <0x0>;
					i2c_addr = <0xc>;
					i2c_num = <0x0>;
					para_num = <0x2>;
					phandle = <0x65>;
					sensor_name = <0x3>;
					status = "okay";

					mag_para_1 {
						match_projects = <0x2269e 0x58a1>;
						soft-mag-parameter = <0x2bcf 0x0 0x3d9 0x0 0x3e1 0x0 0x368 0x0 0x1e97 0x0 0x7cc 0x1 0x97 0x1 0x13d 0x1 0x27fd 0x0>;
					};

					mag_para_2 {
						match_projects = <0x589f 0x58a0 0x2269c 0x2269d>;
						soft-mag-parameter = <0x25b0 0x0 0x3b 0x1 0xb 0x1 0x56 0x1 0x278b 0x0 0xc 0x0 0x80 0x1 0xc0 0x1 0x280b 0x0>;
					};
				};

				pick_up {
					phandle = <0x6a>;
					status = "okay";
					use-proximity = <0x1>;
				};

				proximity_1 {
					anti_shake_delta = <0x50>;
					cal_offset_margin = <0x78>;
					cali_jitter_limit = <0x1e>;
					direction = <0x4>;
					dirty_high_step = <0xfa>;
					dirty_low_step = <0xb4>;
					dynamic_cali_max = <0x400>;
					eint_num = <0xb>;
					force_cali_limit = <0x7d0>;
					high_limit = <0x258>;
					high_step = <0x190>;
					i2c_addr = <0x39>;
					i2c_num = <0x0>;
					low_limit = <0x190>;
					low_step = <0x12c>;
					offset_max = <0xfa>;
					offset_range_max = <0xff>;
					offset_range_min = <0xff>;
					phandle = <0x68>;
					ps_adjust_max = <0x258>;
					ps_adjust_min = <0x0>;
					ps_dirty_limit = <0x3fc>;
					ps_ir_limit = <0x1f4>;
					raw2offset_radio = <0x79e0>;
					sampling_count = <0x5>;
					sensor-reg = <0xbb 0x0 0xb9 0x17 0xbc 0xfb>;
					sensor_name = <0x5>;
					status = "okay";
					step_div = <0x5dc>;
					step_max = <0x190>;
					step_min = <0x6e>;
				};

				sar_1 {
					channel_0_max = <0x11170>;
					channel_0_min = <0x0>;
					channel_1_max = <0x11170>;
					channel_1_min = <0x0>;
					channel_2_max = <0x11170>;
					channel_2_min = <0x0>;
					channel_3_max = <0x11170>;
					channel_3_min = <0x0>;
					channel_num = <0x3>;
					direction = <0x4>;
					eint_num = <0xe>;
					i2c_addr = <0xc>;
					i2c_num = <0x2>;
					phandle = <0x66>;
					reg_table_num = <0x3>;
					sensor_name = <0x0>;
					status = "okay";
				};

				sar_2 {
					channel_0_max = <0x11170>;
					channel_0_min = <0x0>;
					channel_1_max = <0x11170>;
					channel_1_min = <0x0>;
					channel_2_max = <0x11170>;
					channel_2_min = <0x0>;
					channel_3_max = <0x11170>;
					channel_3_min = <0x0>;
					channel_num = <0x3>;
					direction = <0x0>;
					eint_num = <0xe>;
					i2c_addr = <0x12>;
					i2c_num = <0x2>;
					phandle = <0x67>;
					reg_table_num = <0x3>;
					sensor_name = <0x1>;
					status = "okay";
				};
			};

			sensor_fb {
				compatible = "oplus,sensor-feedback";
				phandle = <0x61>;
			};
		};
	};

	fragment@25 {
		target = <0xffffffff>;

		__overlay__ {

			nfc_chipset {
				chipset-22689 = "PN557";
				chipset-2269E = "PN557";
				compatible = "oplus-nfc-chipset";
				phandle = <0x6e>;
			};
		};
	};

	fragment@26 {
		target = <0xffffffff>;

		__overlay__ {
			mediatek,xo-bbck4 = <0x1>;
		};
	};

	fragment@27 {
		target = <0xffffffff>;

		__overlay__ {

			i2c3_pin {
				phandle = <0x2d>;

				pins_cmd0_dat {
					bias-pull-up;
					pinmux = <0x8801>;
				};

				pins_cmd1_dat {
					bias-pull-up;
					pinmux = <0x8901>;
				};
			};
		};
	};

	fragment@28 {
		target = <0xffffffff>;

		__overlay__ {
			pinctrl-0 = <0x2d>;
			status = "okay";

			nfc_nxp@28 {
				compatible = "nxp,pn553";
				interrupt-parent = <0xffffffff>;
				nxp,pn544-clkreq = <0xffffffff 0x44 0x0>;
				nxp,pn544-fw-dwnld = <0xffffffff 0x69 0x0>;
				nxp,pn544-irq = <0xffffffff 0x1 0x0>;
				nxp,pn544-ven = <0xffffffff 0x96 0x0>;
				reg = <0x28>;
			};
		};
	};

	fragment@29 {
		target = <0xffffffff>;

		__overlay__ {
		};
	};

	fragment@3 {
		target = <0xffffffff>;

		__overlay__ {
			#address-cells = <0x1>;
			#size-cells = <0x0>;
			clock-frequency = <0x61a80>;
			status = "okay";

			camera_eeprom1@54 {
				compatible = "mediatek,camera_eeprom";
				phandle = <0x5d>;
				reg = <0x54>;
				status = "okay";
			};

			camera_main_two@78 {
				#thermal-sensor-cells = <0x0>;
				compatible = "mediatek,camera_main_two";
				phandle = <0x1d>;
				reg = <0x78>;
				status = "okay";
			};

			camera_sub@20 {
				#thermal-sensor-cells = <0x0>;
				compatible = "mediatek,camera_sub";
				phandle = <0x1c>;
				reg = <0x20>;
				status = "okay";
			};
		};
	};

	fragment@30 {
		target = <0xffffffff>;

		__overlay__ {
			status = "okay";

			Focaltech22681@38 {
				black_gesture_support;
				charger_pump_support;
				chip-name = "FT3518";
				compatible = "focaltech,fts";
				enable2v8_gpio = <0xffffffff 0x99 0x1>;
				fingerprint_underscreen_support;
				firmware_name = "0xAB54200";
				fw_edge_limit_support;
				fw_update_app_support;
				game_switch_support;
				headset_pump_support;
				health_monitor_support;
				high_resolution_support;
				interrupt-parent = <0xffffffff>;
				interrupts = <0x9 0x2002>;
				irq-gpio = <0xffffffff 0x9 0x2002>;
				lcd_tp_refresh_support;
				panel_type = <0x8>;
				platform_support_project = <0x2269c 0x2269d 0x2269e>;
				platform_support_project_commandline = "default_commandline";
				platform_support_project_dir = <0x2269c 0x2269c 0x2269c>;
				pressure_report_support;
				reg = <0x38>;
				reset-gpio = <0xffffffff 0x98 0x1>;
				smart_gesture_support;
				touchpanel,button-type = <0x4>;
				touchpanel,display-coords = <0x438 0x960>;
				touchpanel,max-num-support = <0xa>;
				touchpanel,panel-coords = <0x10e0 0x2580>;
				touchpanel,report-rate = <0x78 0xb4>;
				touchpanel,sensitive-level = <0xff 0x14 0x10 0xd 0xa 0x5>;
				touchpanel,single-optimized-time = <0x8>;
				touchpanel,smooth-level = <0xff 0x2 0xf 0x19 0x2d 0x3c>;
				touchpanel,smooth-level-charging = <0xff 0xf 0x14 0x19 0x2d 0x3c>;
				touchpanel,touchmajor-limit = <0x0 0xd8>;
				touchpanel,tx-rx-num = <0x10 0x22>;
				touchpanel.button-TRx = <0x0 0x0>;
				tp_type = <0x8>;
				vid_len = <0x2>;
			};
		};
	};

	fragment@31 {
		target = <0xffffffff>;

		__overlay__ {
			accdet-mic-vol = <0x7>;
			accdet-plugout-debounce = <0x1>;
			headset-four-key-threshold = <0x0 0x3a 0x79 0xc0 0x190>;
			headset-mode-setting = <0x500 0x500 0x1 0x1f0 0x800 0x800 0x20 0x44 0x4 0x1 0x5 0x3 0x3 0x5 0xe>;
			headset-three-key-threshold = <0x0 0x52 0xaa 0x190>;
			headset-three-key-threshold-CDD = <0x0 0x79 0xc0 0x258>;
			status = "okay";
		};
	};

	fragment@32 {
		target = <0xffffffff>;

		__overlay__ {
			pinctrl-0 = <0x2e>;
			pinctrl-1 = <0x2f>;
			pinctrl-names = "uart0_rx_gpio", "uart0_tx_gpio";
			status = "okay";
		};
	};

	fragment@33 {
		target = <0xffffffff>;

		__overlay__ {

			uart0_rx_gpio@gpio28 {
				phandle = <0x2e>;

				pins_cmd_dat {
					bias-pull-down;
					input-enable;
					pinmux = <0x1c00>;
					slew-rate = <0x0>;
				};
			};

			uart0_tx_gpio@gpio29 {
				phandle = <0x2f>;

				pins_cmd_dat {
					bias-pull-down;
					input-enable;
					pinmux = <0x1d00>;
					slew-rate = <0x0>;
				};
			};
		};
	};

	fragment@34 {
		target = <0xffffffff>;

		__overlay__ {

			eintdefault {
				phandle = <0x6f>;
			};

			int_active {
				phandle = <0x70>;

				pins_cmd_dat {
					bias-pull-down = <0x0>;
					pinmux = <0x900>;
					slew-rate = <0x0>;
				};
			};

			int_suspend {
				phandle = <0x72>;

				pins_cmd_dat {
					output-low;
					pinmux = <0x900>;
					slew-rate = <0x1>;
				};
			};

			reset_active {
				phandle = <0x71>;

				pins_cmd_dat {
					output-high;
					pinmux = <0x9800>;
					slew-rate = <0x1>;
				};
			};

			reset_suspend {
				phandle = <0x73>;

				pins_cmd_dat {
					output-low;
					pinmux = <0x9800>;
					slew-rate = <0x0>;
				};
			};
		};
	};

	fragment@35 {
		target = <0xffffffff>;

		__overlay__ {
			trustonic,real-drv = <0x1>;
		};
	};

	fragment@36 {
		target = <0xffffffff>;

		__overlay__ {

			led@0 {
				compatible = "mediatek,red";
				data = <0x1>;
				led_mode = <0x0>;
				phandle = <0x74>;
				pwm_config = <0x0 0x0 0x0 0x0 0x0>;
			};

			led@1 {
				compatible = "mediatek,green";
				data = <0x1>;
				led_mode = <0x0>;
				phandle = <0x75>;
				pwm_config = <0x0 0x0 0x0 0x0 0x0>;
			};

			led@2 {
				compatible = "mediatek,blue";
				data = <0x1>;
				led_mode = <0x0>;
				phandle = <0x76>;
				pwm_config = <0x0 0x0 0x0 0x0 0x0>;
			};

			led@3 {
				compatible = "mediatek,jogball-backlight";
				data = <0x1>;
				led_mode = <0x0>;
				phandle = <0x77>;
				pwm_config = <0x0 0x0 0x0 0x0 0x0>;
			};

			led@4 {
				compatible = "mediatek,keyboard-backlight";
				data = <0x1>;
				led_mode = <0x0>;
				phandle = <0x78>;
				pwm_config = <0x0 0x0 0x0 0x0 0x0>;
			};

			led@5 {
				compatible = "mediatek,button-backlight";
				data = <0x1>;
				led_mode = <0x0>;
				phandle = <0x79>;
				pwm_config = <0x0 0x0 0x0 0x0 0x0>;
			};

			led@6 {
				compatible = "mediatek,lcd-backlight";
				data = <0x1>;
				led_mode = <0x4>;
				phandle = <0x7a>;
				pwm_config = <0x0 0x1 0x0 0x0 0x0>;
			};

			usb_c_pinctrl {
				compatible = "mediatek,usb_c_pinctrl";
				phandle = <0x7c>;
			};

			vibrator@0 {
				compatible = "mediatek,vibrator";
				phandle = <0x7b>;
				vib_limit = <0x9>;
				vib_timer = <0x19>;
				vib_vol = <0x9>;
			};
		};
	};

	fragment@37 {
		target = <0xffffffff>;

		__overlay__ {
			compatible = "mediatek,disp-leds";

			backlight {
				default-state = "on";
				label = "lcd-backlight";
				led-bits = <0xc>;
				led_mode = <0x4>;
				max-brightness = <0xfff>;
				max-hw-brightness = <0xfff>;
				trans-bits = <0xc>;
			};
		};
	};

	fragment@38 {
		target = <0xffffffff>;

		__overlay__ {

			lcm_dsi_te {
				phandle = <0x34>;

				pins_cmd_dat {
					pinmux = <0x5301>;
				};
			};

			lcm_led_en0_gpio {
				phandle = <0x31>;

				pins_cmd_dat {
					output-low;
					pinmux = <0xc00>;
					slew-rate = <0x1>;
				};
			};

			lcm_led_en1_gpio {
				phandle = <0x30>;

				pins_cmd_dat {
					output-high;
					pinmux = <0xc00>;
					slew-rate = <0x1>;
				};
			};

			lcm_rst_out0_gpio {
				phandle = <0x33>;

				pins_cmd_dat {
					output-low;
					pinmux = <0x5500>;
					slew-rate = <0x1>;
				};
			};

			lcm_rst_out1_gpio {
				phandle = <0x32>;

				pins_cmd_dat {
					output-high;
					pinmux = <0x5500>;
					slew-rate = <0x1>;
				};
			};
		};
	};

	fragment@39 {
		target = <0xffffffff>;

		__overlay__ {
			pinctrl-0 = <0x30>;
			pinctrl-1 = <0x31>;
			pinctrl-2 = <0x32>;
			pinctrl-3 = <0x33>;
			pinctrl-4 = <0x34>;
			pinctrl-names = "lcm_led_en1_gpio", "lcm_led_en0_gpio", "lcm_rst_out1_gpio", "lcm_rst_out0_gpio", "mode_te_te";
			status = "okay";
		};
	};

	fragment@4 {
		target = <0xffffffff>;

		__overlay__ {

			camera_main {
				phandle = <0x5e>;
				polling-delay = <0x3e8>;
				polling-delay-passive = <0x0>;
				thermal-sensors = <0x1b>;
			};

			camera_main_two {
				phandle = <0x60>;
				polling-delay = <0x3e8>;
				polling-delay-passive = <0x0>;
				thermal-sensors = <0x1d>;
			};

			camera_sub {
				phandle = <0x5f>;
				polling-delay = <0x3e8>;
				polling-delay-passive = <0x0>;
				thermal-sensors = <0x1c>;
			};
		};
	};

	fragment@40 {
		target = <0xffffffff>;

		__overlay__ {
			pinctrl-0 = <0x32>;
			pinctrl-1 = <0x33>;
			pinctrl-2 = <0x34>;
			pinctrl-names = "lcm_rst_out1_gpio", "lcm_rst_out0_gpio", "mode_te_te";
			status = "okay";
		};
	};

	fragment@41 {
		target = <0xffffffff>;

		__overlay__ {
			#address-cells = <0x1>;
			#size-cells = <0x0>;
			status = "okay";

			panel1@0 {
				bias-gpios = <0xffffffff 0x6e 0x0>;
				compatible = "oplus2269C_samsung_ams643ag01_1080p_dsi_cmd,lcm";
				gate-ic = <0x12df>;
				pinctrl-names = "default";
				reg = <0x0>;
				reset-gpios = <0xffffffff 0x55 0x0>;

				port {

					endpoint {
						phandle = <0x36>;
						remote-endpoint = <0x35>;
					};
				};
			};

			ports {

				port {

					endpoint {
						phandle = <0x35>;
						remote-endpoint = <0x36>;
					};
				};
			};
		};
	};

	fragment@42 {
		target = <0xffffffff>;

		__overlay__ {
			compatible = "oplus,fp_common";
			oplus,fp_gpio = <0x3b>;
			oplus,fp_gpio_0 = <0xffffffff 0x3b 0x0>;
			oplus,fp_gpio_num = <0x1>;
			pinctrl-0 = <0x37>;
			pinctrl-1 = <0x38>;
			pinctrl-2 = <0x39>;
			pinctrl-names = "gpio_id0_default", "gpio_id0_pull_up", "gpio_id0_pull_down";

			gf_3956 {
				chip-name = "G_3956";
				eng-menu = "-1,-1";
				oplus,fp-id = <0x0>;
				vendor-chip = <0x1b>;
			};
		};
	};

	fragment@43 {
		target = <0xffffffff>;

		__overlay__ {

			gpio_id0_default {
				phandle = <0x37>;

				pins_cmd_dat {
					bias-pull-up = <0x0>;
					pinmux = <0x3b00>;
					slew-rate = <0x0>;
				};
			};

			gpio_id0_pull_down {
				phandle = <0x39>;

				pins_cmd_dat {
					bias-pull-down = <0x0>;
					pinmux = <0x3b00>;
					slew-rate = <0x0>;
				};
			};

			gpio_id0_pull_up {
				phandle = <0x38>;

				pins_cmd_dat {
					bias-pull-up = <0x0>;
					pinmux = <0x3b00>;
					slew-rate = <0x0>;
				};
			};
		};
	};

	fragment@44 {
		target = <0xffffffff>;

		__overlay__ {
			#address-cells = <0x1>;
			#size-cells = <0x0>;
			status = "okay";

			fingerprint@0 {
				compatible = "oplus,oplus_fp";
				phandle = <0x7d>;
				reg = <0x0>;
				spi-id = <0x3>;
				spi-irq = <0x16>;
				spi-max-frequency = <0x7a1200>;
				spi-reg = <0xa80b88>;
				status = "okay";
			};
		};
	};

	fragment@45 {
		target = <0xffffffff>;

		__overlay__ {
			compatible = "goodix,goodix_fp";
			gf,enable-external-pmic;
			gf,ext-pmic-ldo-mv-max = <0xbb8>;
			gf,ext-pmic-ldo-mv-min = <0x0>;
			gf,ext-pmic-ldo-num = <0x4>;
			goodix,gpio_cs = <0xffffffff 0x2b 0x0>;
			goodix,gpio_irq = <0xffffffff 0x13 0x0>;
			goodix,gpio_reset = <0xffffffff 0x6c 0x0>;
			interrupt-parent = <0xffffffff>;
			interrupts = <0x13 0x1 0x13 0x0>;
			pinctrl-0 = <0x3a 0x3b>;
			pinctrl-1 = <0x3c>;
			pinctrl-names = "default", "gf_cs_func";
			status = "okay";
		};
	};

	fragment@46 {
		target = <0xffffffff>;

		__overlay__ {

			gpio_goodix_cs_func {
				phandle = <0x3c>;

				pins_cmd_dat {
					drive-strength = <0x2>;
					pinmux = <0x2b01>;
				};
			};

			gpio_goodix_irq_default {
				phandle = <0x3a>;

				pins_cmd_dat {
					bias-pull-down;
					pinmux = <0x1300>;
					slew-rate = <0x0>;
				};
			};

			gpio_goodix_reset_default {
				phandle = <0x3b>;

				pins_cmd_dat {
					output-low;
					pinmux = <0x6c00>;
					slew-rate = <0x1>;
				};
			};
		};
	};

	fragment@47 {
		target = <0xffffffff>;

		__overlay__ {

			gps_default {
				phandle = <0x3d>;
			};

			gps_l1_lna@0 {
				phandle = <0x3e>;

				pins_cmd_dat {
					output-low;
					pinmux = <0x1900>;
				};
			};

			gps_l1_lna@1 {
				phandle = <0x3f>;

				pins_cmd_dat {
					pinmux = <0x1902>;
				};
			};

			gps_l1_lna@2 {
				phandle = <0x40>;

				pins_cmd_dat {
					output-high;
					pinmux = <0x1900>;
				};
			};

			gps_l5_lna@0 {
				phandle = <0x41>;

				pins_cmd_dat {
					output-low;
					pinmux = <0x1a00>;
				};
			};

			gps_l5_lna@1 {
				phandle = <0x42>;

				pins_cmd_dat {
					pinmux = <0x1a02>;
				};
			};

			gps_l5_lna@2 {
				phandle = <0x43>;

				pins_cmd_dat {
					output-high;
					pinmux = <0x1a00>;
				};
			};
		};
	};

	fragment@48 {
		target = <0xffffffff>;

		__overlay__ {
			pinctrl-0 = <0x3d>;
			pinctrl-1 = <0x3e>;
			pinctrl-2 = <0x3f>;
			pinctrl-3 = <0x40>;
			pinctrl-4 = <0x41>;
			pinctrl-5 = <0x42>;
			pinctrl-6 = <0x43>;
			pinctrl-names = "default", "gps_l1_lna_disable", "gps_l1_lna_dsp_ctrl", "gps_l1_lna_enable", "gps_l5_lna_disable", "gps_l5_lna_dsp_ctrl", "gps_l5_lna_enable";
			status = "okay";
		};
	};

	fragment@49 {
		target = <0xffffffff>;

		__overlay__ {
			clock-frequency = <0x61a80>;
			pinctrl-0 = <0x44>;
			pinctrl-1 = <0x45>;
			pinctrl-2 = <0x46>;
			pinctrl-3 = <0x47>;
			pinctrl-4 = <0x48>;
			pinctrl-5 = <0x49>;
			pinctrl-names = "default", "ts_int_active", "ts_reset_active", "ts_int_suspend", "ts_reset_suspend", "ts_i2c_mode";

			gt9886@5d {
				compatible = "goodix,gt9886";
				goodix,config-version = "6877v01";
				goodix,firmware-version = "6877v01";
				goodix,input-max-x = <0x438>;
				goodix,input-max-y = <0x8e8>;
				goodix,irq-flags = <0x2>;
				goodix,irq-gpio = <0xffffffff 0x9 0x0>;
				goodix,key-of-pen = <0x14b 0x14c>;
				goodix,panel-key-map = <0x9e 0xac 0xd9>;
				goodix,panel-max-id = <0xa>;
				goodix,panel-max-p = <0x100>;
				goodix,panel-max-w = <0x100>;
				goodix,panel-max-x = <0x438>;
				goodix,panel-max-y = <0x8e8>;
				goodix,pen-enable;
				goodix,power-off-delay-us = <0x1388>;
				goodix,power-on-delay-us = <0x2710>;
				goodix,reset-gpio = <0xffffffff 0x98 0x0>;
				interrupt-parent = <0xffffffff>;
				interrupts = <0x9 0x2 0x9 0x0>;
				reg = <0x5d>;
				status = "ok";
				tpd-filter-custom-prameters = <0x0 0x0 0x0 0x0 0x0 0x0 0x0 0x0 0x0 0x0 0x0 0x0>;
				tpd-filter-custom-speed = <0x0 0x0 0x0>;
				tpd-filter-enable = <0x0>;
				tpd-filter-pixel-density = <0xa1>;
				vtouch-supply = <0xffffffff>;
			};
		};
	};

	fragment@5 {
		target = <0xffffffff>;

		__overlay__ {

			sia81xx_gpio_L {
				phandle = <0x1e>;

				pins_cmd_dat {
					bias-disable;
					pinmux = <0x3400>;
					slew-rate = <0x1>;
				};
			};

			sia81xx_id_L {
				phandle = <0x1f>;

				pins_cmd_dat {
					bias-disable;
					pinmux = <0x3200>;
					slew-rate = <0x1>;
				};
			};
		};
	};

	fragment@50 {
		target = <0xffffffff>;

		__overlay__ {
			#address-cells = <0x1>;
			#size-cells = <0x0>;
			pinctrl-0 = <0x4a>;
			pinctrl-1 = <0x4b>;
			pinctrl-2 = <0x4c>;
			pinctrl-3 = <0x4d>;
			pinctrl-4 = <0x4e>;
			pinctrl-5 = <0x4f>;
			pinctrl-names = "default", "gt9896s_int_active", "gt9896s_reset_active", "gt9896s_int_suspend", "gt9896s_reset_suspend", "gt9896s_spi_mode";
			status = "okay";

			gt9896s@0 {
				compatible = "goodix,gt9896s";
				goodix,avdd-name = "vtouch";
				goodix,config-version = "6789v01";
				goodix,firmware-version = "6789v01";
				goodix,input-max-x = <0x438>;
				goodix,input-max-y = <0x960>;
				goodix,irq-flags = <0x2>;
				goodix,irq-gpio = <0xffffffff 0x9 0x0>;
				goodix,panel-key-map = <0x9e 0xac 0xd9>;
				goodix,panel-max-id = <0xa>;
				goodix,panel-max-p = <0x100>;
				goodix,panel-max-w = <0x100>;
				goodix,panel-max-x = <0x438>;
				goodix,panel-max-y = <0x960>;
				goodix,pen-enable;
				goodix,power-off-delay-us = <0x1388>;
				goodix,power-on-delay-us = <0x2710>;
				goodix,reset-gpio = <0xffffffff 0x98 0x0>;
				goodix,x2x;
				goodix,y2y;
				reg = <0x0>;
				spi-max-frequency = <0xf4240>;
				tpd-filter-custom-prameters = <0x0 0x0 0x0 0x0 0x0 0x0 0x0 0x0 0x0 0x0 0x0 0x0>;
				tpd-filter-custom-speed = <0x0 0x0 0x0>;
				tpd-filter-enable = <0x0>;
				tpd-filter-pixel-density = <0xa1>;
				vtouch-supply = <0xffffffff>;
			};
		};
	};

	fragment@51 {
		target = <0xffffffff>;

		__overlay__ {

			eintdefault {
				phandle = <0x44>;
			};

			i2cmode_default {
				phandle = <0x49>;

				pins_cmd_dat {
					pinmux = <0x8201 0x8301>;
				};
			};

			int1_active {
				phandle = <0x4b>;

				pins_cmd_dat {
					input-enable;
					pinmux = <0x900>;
				};
			};

			int1_suspend {
				phandle = <0x4d>;

				pins_cmd_dat {
					output-low;
					pinmux = <0x900>;
				};
			};

			int_active {
				phandle = <0x45>;

				pins_cmd_dat {
					input-enable;
					pinmux = <0x900>;
				};
			};

			int_suspend {
				phandle = <0x47>;

				pins_cmd_dat {
					output-low;
					pinmux = <0x900>;
				};
			};

			pins_default {
				phandle = <0x4a>;
			};

			reset1_active {
				phandle = <0x4c>;

				pins_cmd_dat {
					output-high;
					pinmux = <0x9800>;
				};
			};

			reset1_suspend {
				phandle = <0x4e>;

				pins_cmd_dat {
					output-low;
					pinmux = <0x9800>;
				};
			};

			reset_active {
				phandle = <0x46>;

				pins_cmd_dat {
					output-high;
					pinmux = <0x9800>;
				};
			};

			reset_suspend {
				phandle = <0x48>;

				pins_cmd_dat {
					output-low;
					pinmux = <0x9800>;
				};
			};

			spimode_default {
				phandle = <0x4f>;

				pins_cmd_dat {
					drive-strength = <0x2>;
					pinmux = <0x1e01 0x1f01 0x2001 0x2101>;
				};
			};
		};
	};

	fragment@52 {
		target = <0xffffffff>;

		__overlay__ {

			aw36518@63 {
				#cooling-cells = <0x2>;
				compatible = "mediatek,flashlights_aw36518";
				decouple = <0x1>;
				phandle = <0x7e>;
				pinctrl-0 = <0x50>;
				pinctrl-1 = <0x51>;
				pinctrl-2 = <0x52>;
				pinctrl-names = "default", "hwen_high", "hwen_low";
				reg = <0x63>;
				status = "okay";

				flash@0 {
					ct = <0x0>;
					part = <0x0>;
					reg = <0x0>;
					type = <0x0>;

					port@0 {

						endpoint {
							phandle = <0x54>;
							remote-endpoint = <0x53>;
						};
					};
				};
			};
		};
	};

	fragment@53 {
		target = <0xffffffff>;

		__overlay__ {

			default {
				phandle = <0x50>;
			};

			hwen_high {
				phandle = <0x51>;

				pins_cmd_dat {
					output-high;
					pinmux = <0x9d00>;
					slew-rate = <0x1>;
				};
			};

			hwen_low {
				phandle = <0x52>;

				pins_cmd_dat {
					output-low;
					pinmux = <0x9d00>;
					slew-rate = <0x1>;
				};
			};
		};
	};

	fragment@54 {
		target = <0xffffffff>;

		__overlay__ {

			port@0 {

				endpoint {
					phandle = <0x53>;
					remote-endpoint = <0x54>;
				};
			};
		};
	};

	fragment@55 {
		target = <0xffffffff>;

		__overlay__ {

			camera_main_three_af@0c {
				compatible = "mediatek,camera_main_three_af";
				phandle = <0x7f>;
				reg = <0xc>;
				status = "okay";
			};
		};
	};

	fragment@56 {
		target = <0xffffffff>;

		__overlay__ {
			camaf_m1_pmic-supply = <0xffffffff>;
			camaf_m3_pmic-supply = <0xffffffff>;
			status = "okay";
		};
	};

	fragment@57 {
		target = <0xffffffff>;

		__overlay__ {

			bq2589x@6a {
				charger_name = "primary_chg";
				compatible = "ti,bq25890h";
				eint_name = "bq2589x";
				interrupt-parent = <0xffffffff>;
				interrupts = <0x4 0x2 0x4 0x0>;
				phandle = <0x21>;
				reg = <0x6a>;
				status = "okay";
				ti,bq2589x,boost-voltage = <0x13c6>;
				ti,bq2589x,charge-detect-enable;
				ti,bq2589x,precharge-current = <0x100>;
				ti,bq2589x,termination-current = <0xfa>;
				ti,bq2589x,usb-vlim = <0x1130>;
			};

			sgm7220@47 {
				compatible = "sgm,usb_type_c";
				reg = <0x47>;
				status = "okay";
			};

			wusb3801x@60 {
				compatible = "mediatek,usb_type_c_wusb3801";
				reg = <0x60>;
				status = "okay";
			};
		};
	};

	fragment@58 {
		target = <0xffffffff>;

		__overlay__ {

			speaker_amp@5c {
				#sound-dai-cells = <0x0>;
				compatible = "richtek,rt5512";
				phandle = <0x55>;
				reg = <0x5c>;
				sound-name-prefix = "Left";
				status = "okay";
			};
		};
	};

	fragment@59 {
		target = <0xffffffff>;

		__overlay__ {
			mediatek,spk-i2s = <0x3 0x0>;

			mediatek,speaker-codec {
				sound-dai = <0x55>;
			};
		};
	};

	fragment@6 {
		target = <0xffffffff>;

		__overlay__ {

			sia81xx@L {
				channel_num = <0x0>;
				compatible = "si,sia81xx";
				dynamic_updata_vdd_port = <0x2>;
				en_dynamic_id = <0x1>;
				en_dynamic_updata_pvdd = <0x0>;
				en_dynamic_updata_vdd = <0x0>;
				en_x_filter = <0x0>;
				owi_mode = <0x9>;
				phandle = <0x20>;
				pinctrl-0 = <0x1e>;
				pinctrl-1 = <0x1f>;
				pinctrl-names = "sia81xx_gpio", "sia81xx_id";
				si,sia81xx_disable_pin = <0x0>;
				si,sia81xx_id = <0xffffffff 0x32 0x0>;
				si,sia81xx_owi = <0xffffffff 0x34 0x0>;
				si,sia81xx_reset = <0xffffffff 0x34 0x0>;
				si,sia81xx_type = "sia8100x";
				timer_task_hdl = <0x0>;
			};
		};
	};

	fragment@60 {
		target = <0xffffffff>;

		__overlay__ {

			active@id0 {
				phandle = <0x58>;

				pins_cmd_dat {
					bias-pull-up;
					input-enable;
					pinmux = <0x2000>;
					slew-rate = <0x0>;
				};
			};

			default@hw_sub_id {
				phandle = <0x56>;
			};

			idle@id0 {
				phandle = <0x59>;

				pins_cmd_dat {
					bias-disable;
					input-enable;
					pinmux = <0x2000>;
					slew-rate = <0x0>;
				};
			};

			sleep@id0 {
				phandle = <0x57>;

				pins_cmd_dat {
					bias-pull-down;
					input-enable;
					pinmux = <0x2000>;
					slew-rate = <0x0>;
				};
			};
		};
	};

	fragment@61 {
		target = <0xffffffff>;

		__overlay__ {

			kpd_volume_down {
				compatible = "mediatek, VOLUME_DOWN-eint";
				debounce = <0x7d00>;
				interrupt-parent = <0xffffffff>;
				interrupts = <0x1a 0x2 0x1a 0x0>;
				phandle = <0x83>;
				status = "okay";
			};

			oplus_boardid {
				compatible = "oplus,oplus_boardid";
				oplus_boardid,dtsino = "2269C";
				oplus_boardid,pcbmask = "0xffff";
				phandle = <0x81>;
			};

			oplus_devinfo {
				compatible = "oplus-devinfo";
				phandle = <0x82>;
				pinctrl-0 = <0x56>;
				pinctrl-1 = <0x57>;
				pinctrl-2 = <0x58>;
				pinctrl-3 = <0x59>;
				pinctrl-names = "default", "aboard_gpio0_sleep", "aboard_gpio0_active", "aboard_gpio0_idle";

				main-sub {
					aboard-gpio0 = <0xffffffff 0x20 0x0>;
					aboard-patterns = <0x2 0x1 0x1>;
					compatible = "hw-match, main-sub";
					match-projects = <0x2269c 0x2269d 0x2269e>;
					use_tristate_gpio;
				};
			};

			oplus_project {
				compatible = "oplus,oplus_project";
				phandle = <0x80>;
			};
		};
	};

	fragment@62 {
		target = <0xffffffff>;

		__overlay__ {

			oplus_sim_detect {
				Hw,sim_det = <0xffffffff 0x17 0x0>;
				compatible = "oplus, sim_detect";
			};
		};
	};

	fragment@63 {
		target = <0xffffffff>;

		__overlay__ {
			keypad,volume-down = <0xffffffff 0x1a 0x0>;
			pinctrl-0 = <0x5a>;
			pinctrl-names = "volume_down_as_int";
			status = "okay";
		};
	};

	fragment@64 {
		target = <0xffffffff>;

		__overlay__ {

			volume_down@0 {
				phandle = <0x5a>;

				pins_cmd_dat {
					input-enable;
					pinmux = <0x1a00>;
					slew-rate = <0x0>;
				};
			};
		};
	};

	fragment@65 {
		target = <0xffffffff>;

		__overlay__ {

			MTEE {
				compatible = "mediatek,mtk_svp_on_mtee_support";
				phandle = <0x84>;
			};

			SecureVideoPath {
				compatible = "mediatek,mtk_sec_video_path_support";
				phandle = <0x85>;
			};
		};
	};

	fragment@66 {
		target = <0xffffffff>;

		__overlay__ {

			charger_ts_ntc {
				phandle = <0x86>;
				polling-delay = <0x0>;
				polling-delay-passive = <0x0>;
				thermal-sensors = <0xffffffff>;
			};

			flash_led_ntc {
				phandle = <0x88>;
				polling-delay = <0x0>;
				polling-delay-passive = <0x0>;
				thermal-sensors = <0xffffffff>;
			};

			sub_bat_temp_ntc {
				phandle = <0x87>;
				polling-delay = <0x0>;
				polling-delay-passive = <0x0>;
				thermal-sensors = <0xffffffff>;
			};
		};
	};

	fragment@67 {
		target = <0xffffffff>;

		__overlay__ {

			shell_back {
				compatible = "oplus,shell-temp";
			};

			shell_frame {
				compatible = "oplus,shell-temp";
			};

			shell_front {
				compatible = "oplus,shell-temp";
			};
		};
	};

	fragment@68 {
		target = <0xffffffff>;

		__overlay__ {
			compatible = "mediatek, swtp-eint";
			debounce = <0x7d000>;
		};
	};

	fragment@69 {
		target = <0xffffffff>;

		__overlay__ {
			compatible = "mediatek, swtp_1-eint";
			debounce = <0x7d000>;
		};
	};

	fragment@7 {
		target = <0xffffffff>;

		__overlay__ {
			si,sia81xx-aux-devs = <0x20>;
			si,sia81xx-aux-devs-prefix = "SpkrLeft sia8102";
			si,sia81xx-max-num = <0x1>;
		};
	};

	fragment@70 {
		target = <0xffffffff>;

		__overlay__ {
			#address-cells = <0x1>;
			#size-cells = <0x0>;
			clock-frequency = <0x61a80>;
			mediatek,use-open-drain;
		};
	};

	fragment@71 {
		target = <0xffffffff>;

		__overlay__ {
			#address-cells = <0x1>;
			#size-cells = <0x0>;
			clock-frequency = <0x61a80>;
			mediatek,use-open-drain;
		};
	};

	fragment@72 {
		target = <0xffffffff>;

		__overlay__ {
			#address-cells = <0x1>;
			#size-cells = <0x0>;
			clock-frequency = <0x61a80>;
			mediatek,use-open-drain;

			camera_main@5a {
				compatible = "mediatek,camera_main";
				reg = <0x5a>;
				status = "okay";
			};

			camera_main_af@18 {
				compatible = "mediatek,camera_main_af";
				reg = <0x18>;
				status = "okay";
			};
		};
	};

	fragment@73 {
		target = <0xffffffff>;

		__overlay__ {
			#address-cells = <0x1>;
			#size-cells = <0x0>;
			clock-frequency = <0x61a80>;
			mediatek,use-open-drain;
		};
	};

	fragment@74 {
		target = <0xffffffff>;

		__overlay__ {
			#address-cells = <0x1>;
			#size-cells = <0x0>;
			clock-frequency = <0x61a80>;
			mediatek,use-open-drain;

			camera_main_two@78 {
				compatible = "mediatek,camera_main_two";
				reg = <0x78>;
				status = "okay";
			};

			camera_sub@20 {
				compatible = "mediatek,camera_sub";
				reg = <0x20>;
				status = "okay";
			};
		};
	};

	fragment@75 {
		target = <0xffffffff>;

		__overlay__ {
			#address-cells = <0x1>;
			#size-cells = <0x0>;
			clock-frequency = <0x61a80>;
			mediatek,use-open-drain;
		};
	};

	fragment@76 {
		target = <0xffffffff>;

		__overlay__ {
			#address-cells = <0x1>;
			#size-cells = <0x0>;
			clock-frequency = <0x61a80>;
			mediatek,use-open-drain;
		};
	};

	fragment@77 {
		target = <0xffffffff>;

		__overlay__ {
			#address-cells = <0x1>;
			#size-cells = <0x0>;
			clock-frequency = <0x61a80>;
			mediatek,use-open-drain;
		};
	};

	fragment@78 {
		target = <0xffffffff>;

		__overlay__ {
			#address-cells = <0x1>;
			#size-cells = <0x0>;
			clock-frequency = <0x61a80>;
			mediatek,use-open-drain;
		};
	};

	fragment@79 {
		target = <0xffffffff>;

		__overlay__ {
			#address-cells = <0x1>;
			#size-cells = <0x0>;
			clock-frequency = <0x61a80>;
			mediatek,use-open-drain;
		};
	};

	fragment@8 {
		target = <0xffffffff>;

		__overlay__ {
			BATT_ID_FAST_CHECK = <0x1>;
			Enable_Is_Force_Full = <0x1>;
			FUELGAGUE_APPLY = <0x1>;
			battery3_profile_t0 = <0x0 0xac4e 0x2bc 0x1f9 0xabac 0x2b5 0x3f2 0xab1f 0x2b0 0x5eb 0xaaa9 0x2bc 0x7e4 0xaa2d 0x2bc 0x9dd 0xa9bc 0x2bc 0xbd6 0xa944 0x2ae 0xdcf 0xa8cf 0x2b8 0xfc8 0xa85c 0x2d2 0x11c1 0xa7e1 0x2bc 0x13bb 0xa769 0x2cc 0x15b4 0xa6eb 0x2bf 0x17ad 0xa675 0x2d1 0x19a6 0xa5f3 0x2d1 0x1b9f 0xa57a 0x2dd 0x1d98 0xa4fc 0x2d5 0x1f91 0xa47e 0x2d5 0x218a 0xa404 0x2e1 0x2383 0xa38b 0x2dc 0x257c 0xa317 0x2ee 0x2775 0xa29b 0x2f4 0x296e 0xa224 0x2fa 0x2b67 0xa1ae 0x2ee 0x2d60 0xa132 0x2ee 0x2f59 0xa0c1 0x2ee 0x3152 0xa055 0x2fc 0x334b 0x9fe7 0x307 0x3544 0x9f77 0x307 0x373d 0x9f0e 0x307 0x3936 0x9ea3 0x307 0x3b30 0x9e35 0x2f1 0x3d29 0x9dcf 0x2f2 0x3f22 0x9d6a 0x307 0x411b 0x9d0b 0x318 0x4314 0x9cb3 0x337 0x450d 0x9c51 0x320 0x4706 0x9bf8 0x32b 0x48ff 0x9ba0 0x339 0x4af8 0x9b47 0x339 0x4cf1 0x9af9 0x358 0x4eea 0x9aa1 0x36b 0x50e3 0x9a41 0x36b 0x52dc 0x99d0 0x369 0x54d5 0x9925 0x319 0x56ce 0x989e 0x307 0x58c7 0x9835 0x2f3 0x5ac0 0x97dc 0x2d7 0x5cb9 0x9799 0x2e5 0x5eb2 0x9754 0x2e4 0x60ab 0x9715 0x2ee 0x62a5 0x96df 0x2ee 0x649e 0x96a4 0x2ee 0x6697 0x9672 0x2ee 0x6890 0x9636 0x2d7 0x6a89 0x960d 0x2ee 0x6c82 0x95da 0x2ee 0x6e7b 0x95af 0x300 0x7074 0x957f 0x2ef 0x726d 0x9557 0x301 0x7466 0x9529 0x2ee 0x765f 0x9503 0x301 0x7858 0x94de 0x307 0x7a51 0x94c2 0x30e 0x7c4a 0x949c 0x312 0x7e43 0x947e 0x31b 0x803c 0x945a 0x320 0x8235 0x9437 0x320 0x842e 0x9418 0x320 0x8627 0x93fb 0x335 0x8820 0x93be 0x31a 0x8a1a 0x9365 0x2ee 0x8c13 0x931a 0x2ee 0x8e0c 0x92e4 0x2ee 0x9005 0x92bb 0x303 0x91fe 0x9289 0x2ee 0x93f7 0x9256 0x2ee 0x95f0 0x9224 0x2ee 0x97e9 0x91fd 0x2e8 0x99e2 0x91d7 0x2e1 0x9bdb 0x91b2 0x2ee 0x9dd4 0x9181 0x307 0x9fcd 0x9138 0x2ee 0xa1c6 0x90f9 0x2ee 0xa3bf 0x90b2 0x2da 0xa5b8 0x9079 0x305 0xa7b1 0x901e 0x2ee 0xa9aa 0x8ff0 0x2df 0xaba3 0x8fe0 0x2d5 0xad9c 0x8fdd 0x307 0xaf95 0x8fcd 0x307 0xb18f 0x8fb3 0x317 0xb388 0x8f88 0x336 0xb581 0x8ed5 0x320 0xb77a 0x8d51 0x32b 0xb973 0x8b4d 0x34a 0xbb6c 0x88b6 0x36a 0xbd65 0x8502 0x3d6 0xbf5e 0x7ef0 0x5a4 0xc157 0x7b98 0x721 0xc350 0x7b98 0x721>;
			battery3_profile_t0_col = <0x3>;
			battery3_profile_t0_num = <0x64>;
			battery3_profile_t1 = <0x0 0xac30 0x33e 0x1f9 0xabaa 0x340 0x3f2 0xab33 0x345 0x5eb 0xaabd 0x339 0x7e4 0xaa55 0x338 0x9dd 0xa9dd 0x330 0xbd6 0xa96c 0x335 0xdcf 0xa8f7 0x335 0xfc8 0xa885 0x33c 0x11c1 0xa810 0x352 0x13bb 0xa791 0x342 0x15b4 0xa713 0x339 0x17ad 0xa69f 0x352 0x19a6 0xa621 0x352 0x1b9f 0xa5a2 0x352 0x1d98 0xa524 0x33b 0x1f91 0xa4b0 0x357 0x218a 0xa432 0x35f 0x2383 0xa3b3 0x352 0x257c 0xa335 0x339 0x2775 0xa2c3 0x358 0x296e 0xa24c 0x35e 0x2b67 0xa1d6 0x352 0x2d60 0xa164 0x36a 0x2f59 0xa0ec 0x35a 0x3152 0xa081 0x36b 0x334b 0xa007 0x356 0x3544 0x9f9f 0x384 0x373d 0x9f3a 0x384 0x3936 0x9ecf 0x375 0x3b30 0x9e66 0x381 0x3d29 0x9e01 0x384 0x3f22 0x9d9c 0x384 0x411b 0x9d3d 0x395 0x4314 0x9cdc 0x39d 0x450d 0x9c81 0x3ca 0x4706 0x9c25 0x3cd 0x48ff 0x9bcb 0x3e8 0x4af8 0x9b6f 0x3e8 0x4cf1 0x9b0f 0x3e1 0x4eea 0x9aba 0x40d 0x50e3 0x9a55 0x414 0x52dc 0x99e5 0x3ff 0x54d5 0x9957 0x3c0 0x56ce 0x98ca 0x381 0x58c7 0x9854 0x36b 0x5ac0 0x97f9 0x354 0x5cb9 0x97ad 0x362 0x5eb2 0x9768 0x343 0x60ab 0x9720 0x339 0x62a5 0x96eb 0x33c 0x649e 0x96b4 0x348 0x6697 0x967c 0x339 0x6890 0x9649 0x339 0x6a89 0x9617 0x339 0x6c82 0x95e9 0x339 0x6e7b 0x95bc 0x339 0x7074 0x9593 0x339 0x726d 0x956d 0x358 0x7466 0x9542 0x35f 0x765f 0x9517 0x33f 0x7858 0x94fb 0x352 0x7a51 0x94d6 0x352 0x7c4a 0x94b5 0x360 0x7e43 0x949c 0x36b 0x803c 0x9479 0x354 0x8235 0x945f 0x373 0x842e 0x9446 0x384 0x8627 0x9424 0x384 0x8820 0x9400 0x36e 0x8a1a 0x93df 0x37a 0x8c13 0x93a6 0x34b 0x8e0c 0x9370 0x339 0x9005 0x9349 0x339 0x91fe 0x9323 0x344 0x93f7 0x92f6 0x341 0x95f0 0x92c4 0x321 0x97e9 0x929d 0x339 0x99e2 0x9277 0x339 0x9bdb 0x9252 0x339 0x9dd4 0x922c 0x352 0x9fcd 0x91f4 0x34b 0xa1c6 0x91a8 0x32c 0xa3bf 0x916c 0x334 0xa5b8 0x912f 0x339 0xa7b1 0x90e9 0x341 0xa9aa 0x9097 0x343 0xaba3 0x9065 0x324 0xad9c 0x9055 0x339 0xaf95 0x904c 0x34c 0xb18f 0x903f 0x35b 0xb388 0x9026 0x368 0xb581 0x8ffb 0x388 0xb77a 0x8f67 0x39d 0xb973 0x8dfe 0x38c 0xbb6c 0x8c01 0x3b3 0xbd65 0x8958 0x3df 0xbf5e 0x859b 0x455 0xc157 0x7f9a 0x608 0xc350 0x7364 0x173e>;
			battery3_profile_t1_col = <0x3>;
			battery3_profile_t1_num = <0x64>;
			battery3_profile_t2 = <0x0 0xac12 0x4e2 0x1f9 0xab8a 0x4e2 0x3f2 0xab0b 0x4d5 0x5eb 0xaa95 0x4c9 0x7e4 0xaa24 0x4c9 0x9dd 0xa9b9 0x4c1 0xbd6 0xa946 0x4be 0xdcf 0xa8d0 0x4b4 0xfc8 0xa85d 0x4c9 0x11c1 0xa7e4 0x4b7 0x13bb 0xa75f 0x497 0x15b4 0xa6ea 0x4ad 0x17ad 0xa66d 0x4b0 0x19a6 0xa5ef 0x4b0 0x1b9f 0xa570 0x49f 0x1d98 0xa4f2 0x4ae 0x1f91 0xa47e 0x4c4 0x218a 0xa400 0x4b0 0x2383 0xa381 0x4b0 0x257c 0xa303 0x497 0x2775 0xa28f 0x4b0 0x296e 0xa216 0x4b0 0x2b67 0xa19c 0x4b0 0x2d60 0xa128 0x498 0x2f59 0xa0b7 0x4b8 0x3152 0xa045 0x4bb 0x334b 0x9fd3 0x4c5 0x3544 0x9f6c 0x4e0 0x373d 0x9efe 0x4d2 0x3936 0x9e93 0x4d3 0x3b30 0x9e2a 0x4f5 0x3d29 0x9dc3 0x4f7 0x3f22 0x9d5a 0x4ec 0x411b 0x9d01 0x50c 0x4314 0x9ca0 0x52b 0x450d 0x9c45 0x52d 0x4706 0x9be4 0x52d 0x48ff 0x9b93 0x563 0x4af8 0x9b34 0x547 0x4cf1 0x9add 0x56b 0x4eea 0x9a88 0x591 0x50e3 0x9a13 0x56b 0x52dc 0x9995 0x544 0x54d5 0x9907 0x4fe 0x56ce 0x987a 0x4ad 0x58c7 0x980d 0x483 0x5ac0 0x97b3 0x465 0x5cb9 0x9767 0x45c 0x5eb2 0x9722 0x45b 0x60ab 0x96e3 0x44f 0x62a5 0x96a3 0x44c 0x649e 0x966c 0x456 0x6697 0x9639 0x455 0x6890 0x9603 0x463 0x6a89 0x95d1 0x44c 0x6c82 0x95a3 0x457 0x6e7b 0x9576 0x465 0x7074 0x954d 0x465 0x726d 0x9527 0x46b 0x7466 0x9501 0x47e 0x765f 0x94db 0x47e 0x7858 0x94b6 0x47e 0x7a51 0x949a 0x47e 0x7c4a 0x9479 0x48c 0x7e43 0x9458 0x497 0x803c 0x943d 0x497 0x8235 0x9423 0x49f 0x842e 0x9404 0x492 0x8627 0x93ef 0x4a9 0x8820 0x93d8 0x4b0 0x8a1a 0x93ba 0x4a6 0x8c13 0x93a2 0x4a7 0x8e0c 0x9383 0x483 0x9005 0x9365 0x48e 0x91fe 0x9333 0x465 0x93f7 0x9300 0x465 0x95f0 0x92d7 0x465 0x97e9 0x92b4 0x470 0x99e2 0x9295 0x48b 0x9bdb 0x9268 0x47e 0x9dd4 0x9235 0x47e 0x9fcd 0x91f6 0x485 0xa1c6 0x91b7 0x497 0xa3bf 0x9178 0x497 0xa5b8 0x9138 0x497 0xa7b1 0x90e3 0x497 0xa9aa 0x908f 0x488 0xaba3 0x906d 0x493 0xad9c 0x905f 0x4b3 0xaf95 0x904b 0x4c0 0xb18f 0x902b 0x4c0 0xb388 0x9012 0x50c 0xb581 0x8fd3 0x54e 0xb77a 0x8eeb 0x583 0xb973 0x8d2a 0x5e7 0xbb6c 0x8ab3 0x6e4 0xbd65 0x8722 0xe4e 0xbf5e 0x80a5 0x2649 0xc157 0x7cc4 0x2f5d 0xc350 0x7cc4 0x2f5d>;
			battery3_profile_t2_col = <0x3>;
			battery3_profile_t2_num = <0x64>;
			battery3_profile_t3 = <0x0 0xac12 0x76c 0x1f9 0xab87 0x793 0x3f2 0xab07 0x7e8 0x5eb 0xaa95 0x7a9 0x7e4 0xaa23 0x769 0x9dd 0xa9b2 0x759 0xbd6 0xa93a 0x7bb 0xdcf 0xa8cd 0x77c 0xfc8 0xa85c 0x767 0x11c1 0xa7de 0x728 0x13bb 0xa75f 0x766 0x15b4 0xa6e1 0x772 0x17ad 0xa66b 0x732 0x19a6 0xa5e5 0x6c0 0x1b9f 0xa56d 0x6e0 0x1d98 0xa4e9 0x767 0x1f91 0xa46c 0x6db 0x218a 0xa3f6 0x6d8 0x2383 0xa377 0x686 0x257c 0xa2f9 0x751 0x2775 0xa27d 0x6fb 0x296e 0xa20c 0x6bc 0x2b67 0xa192 0x691 0x2d60 0xa11e 0x70c 0x2f59 0xa0ad 0x746 0x3152 0xa035 0x6e1 0x334b 0x9fc8 0x6d6 0x3544 0x9f58 0x69d 0x373d 0x9eea 0x74a 0x3936 0x9e7f 0x70c 0x3b30 0x9e16 0x6ef 0x3d29 0x9db1 0x6e4 0x3f22 0x9d4c 0x76d 0x411b 0x9ce7 0x764 0x4314 0x9c82 0x73a 0x450d 0x9c27 0x717 0x4706 0x9bc6 0x755 0x48ff 0x9b67 0x7be 0x4af8 0x9b0b 0x76e 0x4cf1 0x9aa9 0x74d 0x4eea 0x9a3c 0x747 0x50e3 0x99c1 0x7a0 0x52dc 0x9945 0x706 0x54d5 0x98c7 0x6b9 0x56ce 0x984e 0x648 0x58c7 0x97e5 0x6a2 0x5ac0 0x9794 0x6b3 0x5cb9 0x973f 0x62f 0x5eb2 0x96fa 0x60e 0x60ab 0x96bb 0x624 0x62a5 0x9685 0x6c2 0x649e 0x9646 0x636 0x6697 0x9614 0x617 0x6890 0x95e5 0x60e 0x6a89 0x95ab 0x699 0x6c82 0x9580 0x693 0x6e7b 0x9555 0x652 0x7074 0x9525 0x629 0x726d 0x94fd 0x663 0x7466 0x94d4 0x6b1 0x765f 0x94b3 0x678 0x7858 0x948e 0x627 0x7a51 0x9472 0x660 0x7c4a 0x944c 0x6fd 0x7e43 0x942e 0x6a3 0x803c 0x941d 0x69f 0x8235 0x93f5 0x661 0x842e 0x93e2 0x6da 0x8627 0x93c9 0x6e1 0x8820 0x93ba 0x6b4 0x8a1a 0x93a4 0x672 0x8c13 0x9398 0x6e3 0x8e0c 0x9379 0x74e 0x9005 0x9367 0x6d2 0x91fe 0x9341 0x6b2 0x93f7 0x9322 0x6a4 0x95f0 0x92f6 0x764 0x97e9 0x92bb 0x6d0 0x99e2 0x9295 0x6b1 0x9bdb 0x9270 0x6a4 0x9dd4 0x923f 0x76d 0x9fcd 0x91f1 0x787 0xa1c6 0x91a3 0x715 0xa3bf 0x9164 0x6bd 0xa5b8 0x9137 0x732 0xa7b1 0x90cf 0x814 0xa9aa 0x9075 0x7c1 0xaba3 0x9047 0x7b7 0xad9c 0x9035 0x826 0xaf95 0x9007 0x9b7 0xb18f 0x8fd5 0xa83 0xb388 0x8f9d 0xb83 0xb581 0x8f19 0xff8 0xb77a 0x8de9 0x2178 0xb973 0x8b26 0x35c2 0xbb6c 0x7b4c 0x232a 0xbd65 0x7a80 0x2215 0xbf5e 0x7a80 0x2215 0xc157 0x7a80 0x2215 0xc350 0x7a80 0x2215>;
			battery3_profile_t3_col = <0x3>;
			battery3_profile_t3_num = <0x64>;
			battery3_profile_t4 = <0x0 0xac62 0xfa0 0x1f9 0xabc3 0xfa7 0x3f2 0xab3d 0xfb9 0x5eb 0xaabf 0xfa5 0x7e4 0xaa55 0xf9d 0x9dd 0xa9dd 0xf76 0xbd6 0xa96c 0xf5c 0xdcf 0xa8f7 0xf3c 0xfc8 0xa885 0xf23 0x11c1 0xa810 0xf08 0x13bb 0xa798 0xee8 0x15b4 0xa714 0xeae 0x17ad 0xa6a7 0xeb7 0x19a6 0xa621 0xe83 0x1b9f 0xa5a9 0xe74 0x1d98 0xa525 0xe5d 0x1f91 0xa4b0 0xe42 0x218a 0xa432 0xe2b 0x2383 0xa3bb 0xe10 0x257c 0xa349 0xe29 0x2775 0xa2cb 0xdf7 0x296e 0xa252 0xdf7 0x2b67 0xa1d8 0xde4 0x2d60 0xa164 0xdf7 0x2f59 0xa0f3 0xdf7 0x3152 0xa081 0xde9 0x334b 0xa007 0xdde 0x3544 0x9f9e 0xdf7 0x373d 0x9f30 0xdf7 0x3936 0x9ec5 0xdf7 0x3b30 0x9e5c 0xe0d 0x3d29 0x9deb 0xdf7 0x3f22 0x9d7e 0xe01 0x411b 0x9d19 0xe10 0x4314 0x9cb4 0xe10 0x450d 0x9c45 0xdfc 0x4706 0x9be0 0xe10 0x48ff 0x9b7b 0xe10 0x4af8 0x9b0c 0xdf8 0x4cf1 0x9a9a 0xdd8 0x4eea 0x9a23 0xdac 0x50e3 0x99ad 0xd6d 0x52dc 0x9932 0xd2e 0x54d5 0x98cd 0xd16 0x56ce 0x9868 0xcfa 0x58c7 0x980b 0xcf8 0x5ac0 0x97aa 0xccd 0x5cb9 0x9767 0xcdb 0x5eb2 0x971c 0xccb 0x60ab 0x96d9 0xccb 0x62a5 0x96a3 0xce4 0x649e 0x9664 0xcee 0x6697 0x962c 0xcfd 0x6890 0x95f9 0xd14 0x6a89 0x95bf 0xd16 0x6c82 0x9599 0xd2c 0x6e7b 0x956c 0xd48 0x7074 0x9539 0xd48 0x726d 0x9513 0xd67 0x7466 0x94ed 0xd7a 0x765f 0x94c7 0xd8d 0x7858 0x94a1 0xd93 0x7a51 0x947e 0xda1 0x7c4a 0x9465 0xdd3 0x7e43 0x9444 0xdde 0x803c 0x9429 0xdf7 0x8235 0x9413 0xe08 0x842e 0x9400 0xe38 0x8627 0x93ef 0xe6d 0x8820 0x93e3 0xe93 0x8a1a 0x93d2 0xebf 0x8c13 0x93c0 0xedf 0x8e0c 0x93aa 0xf1e 0x9005 0x9399 0xf59 0x91fe 0x9377 0xf84 0x93f7 0x9357 0xfc3 0x95f0 0x9331 0x101a 0x97e9 0x9309 0x1073 0x99e2 0x92d7 0x10ca 0x9bdb 0x929d 0x1149 0x9dd4 0x9267 0x11e0 0x9fcd 0x921c 0x1285 0xa1c6 0x91d0 0x1350 0xa3bf 0x918c 0x1441 0xa5b8 0x9142 0x1572 0xa7b1 0x90e6 0x16c6 0xa9aa 0x9087 0x188c 0xaba3 0x9040 0x1aef 0xad9c 0x9000 0x1e4c 0xaf95 0x8fc1 0x23c9 0xb18f 0x8f82 0x2dfa 0xb388 0x8f3a 0x3c81 0xb581 0x8e78 0x49c4 0xb77a 0x8d4a 0x569f 0xb973 0x8d4a 0x569f 0xbb6c 0x8d4a 0x569f 0xbd65 0x8d4a 0x569f 0xbf5e 0x8d4a 0x569f 0xc157 0x8d4a 0x569f 0xc350 0x8d4a 0x569f>;
			battery3_profile_t4_col = <0x3>;
			battery3_profile_t4_num = <0x64>;
			charger = <0x21>;
			g_FG_PSEUDO100 = <0x5f 0x5f 0x5f 0x5e 0x5e 0x5e 0x5e 0x5c 0x5e 0x5e 0x5e 0x5c 0x5e 0x5e 0x5e 0x5a 0x5c 0x5c 0x5c 0x58 0x64 0x64 0x64 0x64 0x64 0x64 0x64 0x64 0x64 0x64 0x64 0x64 0x64 0x64 0x64 0x64 0x64 0x64 0x64 0x64>;
			g_FG_PSEUDO100_col = <0xa>;
			g_FG_PSEUDO100_row = <0x4>;
			g_FG_charge_PSEUDO100 = <0x64 0x64 0x64 0x64 0x64 0x64 0x64 0x64 0x64 0x64 0x64 0x64 0x64 0x64 0x64 0x64 0x64 0x64 0x64 0x64 0x64 0x64 0x64 0x64 0x64 0x64 0x64 0x64 0x64 0x64 0x64 0x64 0x64 0x64 0x64 0x64 0x64 0x64 0x64 0x64>;
			g_FG_charge_PSEUDO100_col = <0xa>;
			g_FG_charge_PSEUDO100_row = <0x4>;
			g_PMIC_MIN_VOL = <0x82dc 0x82dc 0x82dc 0x82dc 0x80e8 0x80e8 0x80e8 0x80e8 0x80e8 0x80e8 0x80e8 0x80e8 0x7dc8 0x7dc8 0x7dc8 0x7dc8 0x7918 0x7918 0x7918 0x7918 0x7b0c 0x7b0c 0x7b0c 0x7b0c 0x7918 0x7918 0x7918 0x7918 0x7918 0x7918 0x7918 0x7918 0x7918 0x7918 0x7918 0x7918 0x7918 0x7918 0x7918 0x79e0>;
			g_PMIC_MIN_VOL_col = <0xa>;
			g_PMIC_MIN_VOL_row = <0x4>;
			g_PON_SYS_IBOOT = <0x1388 0x1388 0x1388 0x1388 0x1388 0x1388 0x1388 0x1388 0x1388 0x1388 0x1388 0x1388 0x1388 0x1388 0x1388 0x1388 0x1388 0x1388 0x1388 0x1388 0x1388 0x1388 0x1388 0x1388 0x1388 0x1388 0x1388 0x1388 0x1388 0x1388 0x1388 0x1388 0x1388 0x1388 0x1388 0x1388 0x1388 0x1388 0x1388 0x1388>;
			g_PON_SYS_IBOOT_col = <0xa>;
			g_PON_SYS_IBOOT_row = <0x4>;
			g_QMAX_SYS_VOL = <0x84d0 0x84d0 0x84d0 0x84d0 0x84d0 0x84d0 0x84d0 0x84d0 0x84d0 0x84d0 0x84d0 0x84d0 0x82dc 0x82dc 0x82dc 0x82dc 0x8020 0x8020 0x8020 0x8020 0x7ef4 0x7ef4 0x7ef4 0x7ef4 0x8020 0x8020 0x8020 0x8020 0x8020 0x8020 0x8020 0x8020 0x8020 0x8020 0x8020 0x8020 0x8020 0x8020 0x8020 0x8020>;
			g_QMAX_SYS_VOL_col = <0xa>;
			g_QMAX_SYS_VOL_row = <0x4>;
			io-channel-names = "pmic_battery_temp", "pmic_battery_voltage", "pmic_bif_voltage", "pmic_ptim_voltage", "pmic_ptim_r", "auxadc4-batt_id_v";
			io-channels = <0xffffffff 0x3 0xffffffff 0x0 0xffffffff 0xe 0xffffffff 0xf 0xffffffff 0x10 0xffffffff 0x4>;
			ntc_switch_gpio = <0xffffffff 0x6a 0x0>;
			status = "okay";
		};
	};

	fragment@80 {
		target = <0xffffffff>;

		__overlay__ {
			GPIO_FDD_BAND_SUPPORT_DETECT_1ST_PIN = <0xffffffff 0x5c 0x0>;
			GPIO_FDD_BAND_SUPPORT_DETECT_2ND_PIN = <0xffffffff 0x5d 0x0>;
			GPIO_FDD_BAND_SUPPORT_DETECT_3RD_PIN = <0xffffffff 0x5e 0x0>;
			GPIO_SIM1_HOT_PLUG = <0xffffffff 0x17 0x0>;
			GPIO_SIM1_SCLK = <0xffffffff 0x4d 0x0>;
			GPIO_SIM1_SIO = <0xffffffff 0x4f 0x0>;
			GPIO_SIM1_SRST = <0xffffffff 0x4e 0x0>;
			GPIO_SIM2_SCLK = <0xffffffff 0x50 0x0>;
			GPIO_SIM2_SIO = <0xffffffff 0x52 0x0>;
			GPIO_SIM2_SRST = <0xffffffff 0x51 0x0>;
		};
	};

	fragment@81 {
		target = <0xffffffff>;

		__overlay__ {
			gpio_init_default = <0x0 0x0 0x0 0x0 0x1 0x1 0x1 0x1 0x0 0x0 0x0 0x1 0x0 0x1 0x2 0x0 0x0 0x0 0x1 0x0 0x1 0x3 0x0 0x0 0x0 0x1 0x1 0x1 0x4 0x0 0x0 0x0 0x1 0x1 0x1 0x5 0x0 0x0 0x0 0x1 0x1 0x1 0x6 0x0 0x0 0x0 0x1 0x1 0x1 0x7 0x0 0x0 0x0 0x1 0x0 0x1 0x8 0x0 0x0 0x0 0x1 0x0 0x1 0x9 0x0 0x0 0x0 0x1 0x1 0x1 0xa 0x0 0x0 0x0 0x1 0x0 0x1 0xb 0x0 0x0 0x0 0x1 0x1 0x1 0xc 0x0 0x0 0x0 0x1 0x0 0x1 0xd 0x6 0x0 0x0 0x1 0x0 0x1 0xe 0x0 0x0 0x0 0x1 0x1 0x1 0xf 0x0 0x1 0x1 0x1 0x0 0x0 0x10 0x0 0x1 0x0 0x1 0x0 0x0 0x11 0x0 0x0 0x0 0x1 0x0 0x0 0x12 0x0 0x1 0x0 0x1 0x0 0x0 0x13 0x0 0x0 0x0 0x1 0x0 0x0 0x14 0x0 0x0 0x0 0x1 0x0 0x0 0x15 0x0 0x0 0x0 0x1 0x0 0x0 0x16 0x0 0x1 0x0 0x1 0x0 0x0 0x17 0x1 0x0 0x0 0x1 0x1 0x0 0x18 0x0 0x0 0x0 0x1 0x0 0x0 0x19 0x2 0x0 0x0 0x1 0x0 0x1 0x1a 0x0 0x0 0x0 0x1 0x1 0x1 0x1b 0x0 0x0 0x0 0x1 0x0 0x1 0x1c 0x1 0x0 0x0 0x1 0x1 0x1 0x1d 0x1 0x0 0x0 0x0 0x0 0x1 0x1e 0x0 0x0 0x0 0x1 0x1 0x1 0x1f 0x1 0x0 0x0 0x0 0x0 0x1 0x20 0x0 0x0 0x0 0x1 0x0 0x1 0x21 0x0 0x0 0x0 0x1 0x0 0x1 0x22 0x6 0x0 0x0 0x1 0x0 0x0 0x23 0x6 0x0 0x0 0x1 0x0 0x0 0x24 0x0 0x0 0x0 0x1 0x1 0x1 0x25 0x0 0x0 0x0 0x1 0x1 0x1 0x26 0x2 0x0 0x0 0x0 0x0 0x1 0x27 0x2 0x0 0x0 0x0 0x0 0x1 0x28 0x2 0x0 0x0 0x0 0x0 0x1 0x29 0x2 0x0 0x0 0x1 0x0 0x1 0x2a 0x1 0x0 0x0 0x0 0x0 0x1 0x2b 0x0 0x1 0x0 0x1 0x0 0x1 0x2c 0x1 0x0 0x0 0x0 0x0 0x1 0x2d 0x1 0x0 0x0 0x1 0x0 0x1 0x2e 0x6 0x0 0x0 0x0 0x0 0x0 0x2f 0x6 0x0 0x0 0x1 0x0 0x0 0x30 0x6 0x0 0x0 0x0 0x0 0x0 0x31 0x6 0x0 0x0 0x1 0x0 0x0 0x32 0x2 0x0 0x0 0x0 0x0 0x1 0x33 0x0 0x0 0x0 0x1 0x0 0x1 0x34 0x2 0x0 0x0 0x0 0x0 0x1 0x35 0x2 0x0 0x0 0x1 0x0 0x1 0x37 0x0 0x0 0x0 0x1 0x0 0x1 0x38 0x0 0x0 0x0 0x1 0x0 0x1 0x39 0x0 0x0 0x0 0x1 0x0 0x1 0x3a 0x0 0x0 0x0 0x1 0x0 0x1 0x3b 0x0 0x1 0x0 0x1 0x0 0x1 0x3c 0x0 0x1 0x0 0x1 0x0 0x1 0x3d 0x0 0x0 0x0 0x1 0x0 0x1 0x3e 0x0 0x0 0x0 0x1 0x0 0x1 0x3f 0x0 0x0 0x0 0x1 0x0 0x1 0x40 0x0 0x0 0x0 0x1 0x0 0x1 0x41 0x0 0x0 0x0 0x1 0x0 0x1 0x42 0x1 0x0 0x0 0x1 0x1 0x1 0x43 0x0 0x0 0x0 0x1 0x0 0x1 0x44 0x5 0x0 0x0 0x1 0x0 0x1 0x45 0x0 0x0 0x0 0x1 0x0 0x1 0x47 0x1 0x0 0x0 0x1 0x0 0x1 0x48 0x1 0x0 0x0 0x1 0x0 0x1 0x49 0x1 0x0 0x0 0x1 0x0 0x1 0x4a 0x1 0x0 0x0 0x1 0x0 0x1 0x4b 0x1 0x0 0x0 0x1 0x0 0x1 0x4c 0x1 0x0 0x0 0x1 0x0 0x1 0x4d 0x1 0x0 0x0 0x0 0x0 0x1 0x4e 0x1 0x0 0x0 0x0 0x0 0x1 0x4f 0x1 0x0 0x0 0x1 0x1 0x1 0x50 0x1 0x0 0x0 0x0 0x0 0x1 0x51 0x1 0x0 0x0 0x0 0x0 0x1 0x52 0x1 0x0 0x0 0x1 0x1 0x1 0x53 0x1 0x0 0x0 0x1 0x0 0x1 0x54 0x0 0x0 0x0 0x1 0x0 0x1 0x55 0x0 0x1 0x0 0x1 0x0 0x0 0x56 0x1 0x0 0x0 0x1 0x0 0x0 0x57 0x1 0x0 0x0 0x1 0x0 0x0 0x58 0x1 0x0 0x0 0x1 0x0 0x0 0x59 0x1 0x0 0x0 0x1 0x0 0x0 0x5a 0x1 0x0 0x0 0x1 0x0 0x0 0x5b 0x1 0x0 0x0 0x1 0x0 0x0 0x5c 0x0 0x0 0x0 0x1 0x0 0x0 0x5d 0x0 0x0 0x0 0x1 0x0 0x0 0x5e 0x0 0x0 0x0 0x1 0x0 0x0 0x5f 0x1 0x0 0x0 0x1 0x0 0x0 0x60 0x1 0x0 0x0 0x1 0x0 0x0 0x61 0x1 0x0 0x0 0x1 0x0 0x0 0x62 0x1 0x0 0x0 0x1 0x0 0x0 0x63 0x0 0x0 0x0 0x1 0x0 0x0 0x64 0x0 0x0 0x0 0x1 0x0 0x0 0x65 0x0 0x0 0x0 0x1 0x0 0x0 0x66 0x1 0x0 0x0 0x1 0x0 0x0 0x67 0x1 0x0 0x0 0x1 0x0 0x0 0x68 0x1 0x0 0x0 0x0 0x0 0x0 0x69 0x0 0x1 0x0 0x1 0x0 0x1 0x6a 0x0 0x1 0x1 0x1 0x0 0x0 0x6b 0x1 0x0 0x0 0x1 0x0 0x0 0x6c 0x0 0x1 0x0 0x1 0x0 0x0 0x6d 0x1 0x0 0x0 0x1 0x0 0x0 0x6e 0x0 0x1 0x1 0x1 0x0 0x0 0x6f 0x1 0x0 0x0 0x1 0x0 0x0 0x70 0x1 0x0 0x0 0x0 0x0 0x0 0x71 0x1 0x0 0x0 0x1 0x0 0x0 0x72 0x0 0x0 0x0 0x1 0x0 0x0 0x73 0x0 0x0 0x0 0x1 0x0 0x0 0x74 0x0 0x0 0x0 0x1 0x0 0x0 0x75 0x0 0x0 0x0 0x1 0x0 0x0 0x76 0x0 0x0 0x0 0x1 0x0 0x0 0x77 0x0 0x0 0x0 0x1 0x0 0x0 0x78 0x0 0x0 0x0 0x1 0x0 0x0 0x79 0x0 0x0 0x0 0x1 0x0 0x0 0x7a 0x1 0x0 0x0 0x0 0x0 0x0 0x7b 0x1 0x0 0x0 0x0 0x0 0x0 0x7c 0x1 0x0 0x0 0x1 0x0 0x0 0x7d 0x1 0x0 0x0 0x1 0x0 0x0 0x7e 0x1 0x0 0x0 0x1 0x0 0x0 0x7f 0x1 0x0 0x0 0x1 0x0 0x0 0x80 0x0 0x0 0x0 0x0 0x0 0x0 0x81 0x1 0x0 0x0 0x1 0x0 0x0 0x82 0x1 0x0 0x0 0x0 0x0 0x1 0x83 0x1 0x0 0x0 0x0 0x0 0x1 0x84 0x2 0x0 0x0 0x1 0x1 0x0 0x85 0x2 0x0 0x0 0x1 0x1 0x0 0x86 0x1 0x0 0x0 0x1 0x1 0x1 0x87 0x1 0x0 0x0 0x1 0x1 0x1 0x88 0x1 0x0 0x0 0x1 0x1 0x1 0x89 0x1 0x0 0x0 0x1 0x1 0x1 0x8a 0x0 0x1 0x0 0x1 0x0 0x0 0x8b 0x0 0x1 0x0 0x1 0x0 0x0 0x8c 0x1 0x0 0x0 0x1 0x1 0x1 0x8d 0x1 0x0 0x0 0x1 0x1 0x1 0x8e 0x1 0x0 0x0 0x1 0x1 0x1 0x8f 0x1 0x0 0x0 0x1 0x1 0x1 0x90 0x1 0x0 0x0 0x1 0x1 0x1 0x91 0x1 0x0 0x0 0x1 0x1 0x1 0x92 0x1 0x0 0x0 0x1 0x1 0x1 0x93 0x1 0x0 0x0 0x1 0x1 0x1 0x94 0x2 0x0 0x0 0x1 0x1 0x1 0x95 0x2 0x0 0x0 0x1 0x1 0x1 0x96 0x0 0x1 0x0 0x1 0x0 0x1 0x97 0x0 0x1 0x0 0x1 0x0 0x1 0x98 0x0 0x1 0x0 0x1 0x0 0x1 0x99 0x0 0x1 0x0 0x1 0x0 0x1 0x9a 0x0 0x1 0x1 0x1 0x0 0x1 0x9b 0x0 0x1 0x0 0x1 0x0 0x1 0x9c 0x0 0x1 0x0 0x1 0x0 0x1 0x9d 0x0 0x1 0x0 0x1 0x0 0x1 0x9e 0x0 0x1 0x1 0x1 0x0 0x1 0x9f 0x0 0x1 0x0 0x1 0x0 0x0 0xa0 0x1 0x0 0x0 0x0 0x0 0x1 0xa1 0x1 0x0 0x0 0x0 0x0 0x1 0xa2 0x1 0x0 0x0 0x0 0x0 0x1 0xa3 0x1 0x0 0x0 0x1 0x0 0x1 0xa4 0x1 0x0 0x0 0x0 0x0 0x1 0xa5 0x1 0x0 0x0 0x0 0x0 0x1 0xa6 0x1 0x0 0x0 0x0 0x0 0x1 0xa7 0x1 0x0 0x0 0x1 0x0 0x1 0xa8 0x1 0x0 0x0 0x0 0x0 0x0 0xa9 0x1 0x0 0x0 0x0 0x0 0x1 0xaa 0x1 0x0 0x0 0x0 0x0 0x1 0xab 0x1 0x0 0x0 0x0 0x0 0x1 0xac 0x1 0x0 0x0 0x0 0x0 0x1 0xad 0x1 0x0 0x0 0x1 0x0 0x1 0xae 0x1 0x0 0x0 0x1 0x0 0x1 0xaf 0x1 0x0 0x0 0x1 0x0 0x1 0xb0 0x1 0x0 0x0 0x1 0x0 0x1 0xb1 0x0 0x0 0x0 0x1 0x0 0x0 0xb2 0x0 0x0 0x0 0x1 0x0 0x0 0xb3 0x0 0x0 0x0 0x1 0x0 0x0 0xb4 0x0 0x0 0x0 0x1 0x0 0x0 0xb5 0x0 0x0 0x0 0x1 0x0 0x0 0xb6 0x0 0x0 0x0 0x1 0x0 0x0 0xb7 0x0 0x0 0x0 0x1 0x0 0x0 0xb8 0x0 0x0 0x0 0x1 0x0 0x0 0xb9 0x0 0x0 0x0 0x1 0x0 0x0 0xba 0x0 0x0 0x0 0x1 0x0 0x1 0xbb 0x0 0x0 0x0 0x1 0x0 0x1 0xbc 0x0 0x0 0x0 0x1 0x0 0x0 0xbd 0x0 0x0 0x0 0x1 0x0 0x0 0xbe 0x0 0x0 0x0 0x1 0x0 0x0 0xbf 0x0 0x0 0x0 0x1 0x0 0x0 0xc0 0x0 0x0 0x0 0x1 0x0 0x0 0xc1 0x0 0x0 0x0 0x1 0x0 0x0 0xc2 0x0 0x0 0x0 0x1 0x0 0x0 0xc3 0x0 0x0 0x0 0x1 0x0 0x0 0xc4 0x0 0x0 0x0 0x1 0x0 0x0 0xc5 0x0 0x0 0x0 0x1 0x0 0x0 0xc6 0x0 0x0 0x0 0x1 0x0 0x0 0xc7 0x0 0x0 0x0 0x1 0x0 0x0 0xc8 0x0 0x0 0x0 0x1 0x0 0x0 0xc9 0x0 0x0 0x0 0x1 0x0 0x0 0xca 0x0 0x0 0x0 0x1 0x0 0x0 0xcb 0x0 0x0 0x0 0x1 0x0 0x0 0xcc 0x0 0x0 0x0 0x1 0x0 0x0 0xcd 0x0 0x0 0x0 0x1 0x0 0x0 0xce 0x0 0x0 0x0 0x1 0x0 0x0 0xcf 0x0 0x0 0x0 0x1 0x0 0x0 0xd0 0x0 0x0 0x0 0x1 0x0 0x0 0xd1 0x0 0x0 0x0 0x1 0x0 0x0 0xd2 0x0 0x0 0x0 0x1 0x0 0x0 0xd3 0x0 0x0 0x0 0x1 0x0 0x0 0xd4 0x0 0x0 0x0 0x1 0x0 0x0 0xd5 0x0 0x0 0x0 0x1 0x0 0x0 0xd6 0x0 0x0 0x0 0x1 0x0 0x0 0xd7 0x0 0x0 0x0 0x1 0x0 0x0 0xd8 0x0 0x0 0x0 0x1 0x0 0x0 0xd9 0x0 0x0 0x0 0x1 0x0 0x0 0xda 0x0 0x0 0x0 0x1 0x0 0x0 0xdb 0x0 0x0 0x0 0x1 0x0 0x0 0xdc 0x0 0x0 0x0 0x1 0x0 0x0 0xdd 0x0 0x0 0x0 0x1 0x0 0x0>;
		};
	};

	fragment@82 {
		target = <0xffffffff>;

		__overlay__ {
			interrupt-parent = <0xffffffff>;
			interrupts = <0x0 0x8>;
			status = "okay";
		};
	};

	fragment@83 {
		target = <0xffffffff>;

		__overlay__ {
			interrupt-parent = <0xffffffff>;
			interrupts = <0x4 0x8>;
			status = "okay";
		};
	};

	fragment@84 {
		target = <0xffffffff>;

		__overlay__ {
			interrupt-parent = <0xffffffff>;
			interrupts = <0x6 0x8>;
			status = "okay";
		};
	};

	fragment@85 {
		target = <0xffffffff>;

		__overlay__ {
			interrupt-parent = <0xffffffff>;
			interrupts = <0x9 0x2>;
			status = "okay";
		};
	};

	fragment@86 {
		target = <0xffffffff>;

		__overlay__ {
			interrupt-parent = <0xffffffff>;
			interrupts = <0x13 0x8>;
			status = "okay";
		};
	};

	fragment@87 {
		target = <0xffffffff>;

		__overlay__ {
			deb-gpios = <0xffffffff 0x1e 0x0>;
			debounce = <0x7d000>;
			interrupt-parent = <0xffffffff>;
			interrupts = <0x1e 0x4>;
			status = "okay";
		};
	};

	fragment@88 {
		target = <0xffffffff>;

		__overlay__ {
			interrupt-parent = <0xffffffff>;
			interrupts = <0x53 0x1>;
			status = "okay";
		};
	};

	fragment@89 {
		target = <0xffffffff>;

		__overlay__ {
			compatible = "mediatek,md1_sim1_hot_plug_eint-eint";
			debounce = <0x0 0x2710>;
			dedicated = <0x0 0x0>;
			interrupts = <0x0 0x8>;
			sockettype = <0x0 0x0>;
			src_pin = <0x0 0x1>;
			status = "okay";
		};
	};

	fragment@9 {
		target = <0xffffffff>;

		__overlay__ {
			mediatek,eye-vrt = <0x0>;
			mediatek,rev6 = <0x3>;
		};
	};

	fragment@90 {
		target = <0xffffffff>;

		__overlay__ {
			compatible = "mediatek,md1_sim2_hot_plug_eint-eint";
			debounce = <0x1 0x2710>;
			dedicated = <0x1 0x0>;
			interrupts = <0x1 0x8>;
			sockettype = <0x1 0x0>;
			src_pin = <0x1 0x2>;
			status = "okay";
		};
	};

	fragment@91 {
		target = <0xffffffff>;

		__overlay__ {
			mediatek,hw-dl-key0 = <0x11>;
			mediatek,hw-dl-key1 = <0x0>;
			mediatek,hw-dl-key2 = <0x8>;
			mediatek,hw-factory-key = <0x0>;
			mediatek,hw-init-map = <0x72 0x0 0x0 0x0 0x0 0x0 0x0 0x0 0x0 0x0 0x0 0x0 0x0 0x0 0x0 0x0 0x0 0x0 0x0 0x0 0x0 0x0 0x0 0x0 0x0 0x0 0x0 0x0 0x0 0x0 0x0 0x0 0x0 0x0 0x0 0x0 0x0 0x0 0x0 0x0 0x0 0x0 0x0 0x0 0x0 0x0 0x0 0x0 0x0 0x0 0x0 0x0 0x0 0x0 0x0 0x0 0x0 0x0 0x0 0x0 0x0 0x0 0x0 0x0 0x0 0x0 0x0 0x0 0x0 0x0 0x0 0x0>;
			mediatek,hw-map-num = <0x48>;
			mediatek,hw-pwrkey = <0x8>;
			mediatek,hw-recovery-key = <0x11>;
			mediatek,hw-rstkey = <0x11>;
			mediatek,key-debounce = <0x400>;
			mediatek,pwkey-gpio-din = <0x0>;
			mediatek,pwrkey-eint-gpio = <0x0>;
			mediatek,sw-pwrkey = <0x74>;
			mediatek,sw-rstkey = <0x73>;
			mediatek,use-extend-type = <0x0>;
			status = "okay";
		};
	};
};
